## boards/shields/seeed_wio_lr2021/Kconfig.shield
```kconfig
# Copyright (c) 2026 Seeed Technology Co., Ltd.
# SPDX-License-Identifier: LicenseRef-Nordic-5-Clause

config SHIELD_SEEED_WIO_LR2021
	def_bool $(shields_list_contains,seeed_wio_lr2021)
```

## boards/shields/semtech_wio_lr20xx/Kconfig.shield
```kconfig
# Copyright (c) 2026 Seeed Technology Co., Ltd.
# SPDX-License-Identifier: LicenseRef-Nordic-5-Clause

config SHIELD_SEMTECH_WIO_LR20XX
	def_bool $(shields_list_contains,semtech_wio_lr20xx)
```

## samples/sid_location/sysbuild/mcuboot/boards/nrf52840dk_nrf52840.conf
```kconfig
#
# Copyright (c) 2026 Nordic Semiconductor ASA
#
# SPDX-License-Identifier: LicenseRef-Nordic-5-Clause
#

CONFIG_NORDIC_QSPI_NOR_STACK_WRITE_BUFFER_SIZE=16
CONFIG_DISABLE_FLASH_PATCH=y
CONFIG_REBOOT=y
```

## samples/sid_location/sysbuild/mcuboot/boards/nrf54l15tag_nrf54l15_cpuapp.conf
```kconfig
#
# Copyright (c) 2026 Nordic Semiconductor ASA
#
# SPDX-License-Identifier: LicenseRef-Nordic-5-Clause
#

CONFIG_HW_STACK_PROTECTION=n
CONFIG_BOOT_WATCHDOG_FEED=n
CONFIG_MCUBOOT_CLEANUP_RAM=y
CONFIG_UART_CONSOLE=n
```

## samples/sid_location/sysbuild/mcuboot/boards/nrf54lm20dk_nrf54lm20a_cpuapp.conf
```kconfig
#
# Copyright (c) 2026 Nordic Semiconductor ASA
#
# SPDX-License-Identifier: LicenseRef-Nordic-5-Clause
#

CONFIG_HW_STACK_PROTECTION=n
CONFIG_BOOT_WATCHDOG_FEED=n
```
