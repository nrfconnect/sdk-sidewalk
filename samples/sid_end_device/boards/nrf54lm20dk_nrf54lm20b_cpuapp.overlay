/*
 * Copyright (c) 2025 Nordic Semiconductor ASA
 *
 * SPDX-License-Identifier: LicenseRef-Nordic-5-Clause
 */

#include <state_notifier_aliases.dtsi>

&adc {
	status = "disabled";
};

/* Disable SPI NOR flash - not needed for Sidewalk samples */
&spi00 {
	status = "disabled";
};

#include <nrf54lm20_cpuapp_partitions.dtsi>
