/*
 * Copyright (c) 2023 Nordic Semiconductor ASA
 *
 * SPDX-License-Identifier: LicenseRef-Nordic-5-Clause
 */

&i2c1 {
	status = "okay";

	bme688@76 {
		compatible = "bosch,bme680";
		reg = <0x76>;
		status = "okay";
	};
};

/{
	chosen {
		nordic,pm-ext-flash = &mx25r64;
	};
};
