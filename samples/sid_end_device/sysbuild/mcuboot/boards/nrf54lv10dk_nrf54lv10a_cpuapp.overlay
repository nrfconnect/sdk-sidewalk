/*
 * Copyright (c) 2025 Nordic Semiconductor ASA
 *
 * SPDX-License-Identifier: LicenseRef-Nordic-5-Clause
 */

#include "../../../boards/nrf54lv10dk_nrf54lv10a_cpuapp.overlay"
#include <mcuboot_boot_partition.dtsi>
