## samples/sid_end_device/sysbuild/mcuboot/boards/nrf54lv10dk_nrf54lv10a_cpuapp.conf
```kconfig
#
# Copyright (c) 2026 Nordic Semiconductor ASA
#
# SPDX-License-Identifier: LicenseRef-Nordic-5-Clause
#

# Currently, without tickless kernel, the SYSCOUNTER value after the software
# reset is not set properly and due to that the first system interrupt is not called
# in the proper time - the SYSCOUNTER value is set to the value from before
# reset + 1. Hence, the reboot time increases more and more.
# To avoid it enable tickles kernel for mcuboot.
CONFIG_TICKLESS_KERNEL=y

CONFIG_BOOT_WATCHDOG_FEED=n

# Ensure that the spi driver is disabled by default
CONFIG_SPI=n
CONFIG_SPI_NOR=n
```

## samples/sid_template/sample.yaml
```yaml
sample:
  name: Sidewalk template
  description: Sample implementing Amazon Sidewalk End Device
tests:
  sample.basic.sid_template:
    build_only: true
    platform_allow: nrf52840dk_nrf52840
    integration_platforms:
      - nrf52840dk_nrf52840
    tags: Sidewalk
```

## samples/template_ble/child_image/mcuboot/Kconfig.root
```kconfig
#
# Copyright (c) 2022 Nordic Semiconductor ASA
#
# SPDX-License-Identifier: LicenseRef-Nordic-4-Clause
#


# The purpose of this file is to create a wrapper Kconfig file that will be set as
# mcuboot_KCONFIG_ROOT and processed before any other Kconfig for mcuboot child image.

rsource "../../../common/Kconfig.mcuboot.defaults"
source "${ZEPHYR_BASE}/../bootloader/mcuboot/boot/zephyr/Kconfig"
```

## samples/template_subghz/child_image/mcuboot/Kconfig.root
```kconfig
#
# Copyright (c) 2022 Nordic Semiconductor ASA
#
# SPDX-License-Identifier: LicenseRef-Nordic-5-Clause
#

rsource "../../../common/Kconfig.mcuboot.defaults"
rsource "../../../common/Kconfig.mcuboot.external_flash"
source "${ZEPHYR_BASE}/../bootloader/mcuboot/boot/zephyr/Kconfig"
```

## subsys/hal/Kconfig
```kconfig
#
# Copyright (c) 2022 Nordic Semiconductor ASA
#
# SPDX-License-Identifier: LicenseRef-Nordic-4-Clause
#

config SIDEWALK_HAL
	bool "Amazon Sidewalk HAL for nRF Connect SDK"
	default y if SIDEWALK

config SIDEWALK_HAL_BUTTONS
	bool
	default y if SIDEWALK

config NOTIFIER_HANDLER_MAX
	int "Maximum number of the notifier listeners"
	default 2 if LOG
	default 1
```

## tests/example_test/Kconfig
```kconfig
#
# Copyright (c) 2022 Nordic Semiconductor ASA
#
# SPDX-License-Identifier: LicenseRef-Nordic-4-Clause
#

mainmenu "Example unity test"

menu "Unit under test configuration"

endmenu

source "Kconfig.zephyr"
```

## tests/functional/critical_region/testcase.yaml
```yaml
tests:
  sidewalk.functional.critical_region:
    platform_allow: nrf52840dk_nrf52840
    tags: Sidewalk
    integration_platforms:
      - nrf52840dk
```

## tests/functional/crypto/testcase.yaml
```yaml
tests:
  sidewalk.functional.crypto:
    sysbuild: true
    tags: Sidewalk
    platform_allow:
      - nrf52840dk/nrf52840
      - nrf5340dk/nrf5340/cpuapp
      - nrf54l15pdk/nrf54l15/cpuapp
      - nrf54l15pdk/nrf54l15/cpuapp/ns
    integration_platforms:
      - nrf52840dk/nrf52840
      - nrf5340dk/nrf5340/cpuapp
      - nrf54l15pdk/nrf54l15/cpuapp
      - nrf54l15pdk/nrf54l15/cpuapp/ns
```

## tests/functional/crypto_keys/testcase.yaml
```yaml
tests:
  sidewalk.functional.crypto_keys:
    sysbuild: true
    tags: Sidewalk
    platform_allow: nrf52840dk/nrf52840 nrf5340dk/nrf5340/cpuapp nrf54l15dk/nrf54l15/cpuapp
    integration_platforms:
      - nrf52840dk/nrf52840
      - nrf5340dk/nrf5340/cpuapp
      - nrf54l15dk/nrf54l15/cpuapp
```

## tests/functional/interrupts/testcase.yaml
```yaml
tests:
  unity.sidewalk.functional.interrupts:
    sysbuild: true
    tags: Sidewalk
    platform_allow:
      - nrf52840dk/nrf52840
      - nrf5340dk/nrf5340/cpuapp
      - nrf54l15dk/nrf54l15/cpuapp
      - nrf54l15dk/nrf54l15/cpuapp/ns
      - nrf54l15dk/nrf54l10/cpuapp
    integration_platforms:
      - nrf52840dk/nrf52840
      - nrf5340dk/nrf5340/cpuapp
      - nrf54l15dk/nrf54l15/cpuapp
      - nrf54l15dk/nrf54l15/cpuapp/ns
      - nrf54l15dk/nrf54l10/cpuapp
```

## tests/functional/mfg_storage/testcase.yaml
```yaml
tests:
  sidewalk.test.integration.mfg_storage:
    skip: true
    sysbuild: true
    tags: Sidewalk
    platform_allow:
      - nrf52840dk/nrf52840
      - nrf5340dk/nrf5340/cpuapp
      - nrf54l15dk/nrf54l15/cpuapp
      - nrf54l15dk/nrf54l15/cpuapp/ns
      - nrf54l15dk/nrf54l10/cpuapp
    integration_platforms:
      - nrf52840dk/nrf52840
      - nrf5340dk/nrf5340/cpuapp
      - nrf54l15dk/nrf54l15/cpuapp
      - nrf54l15dk/nrf54l15/cpuapp/ns
      - nrf54l15dk/nrf54l10/cpuapp

  sidewalk.test.integration.mfg_storage_deprecated:
    skip: true
    sysbuild: true
    tags: Sidewalk
    platform_allow: nrf52840dk/nrf52840 nrf5340dk/nrf5340/cpuapp nrf54l15dk/nrf54l15/cpuapp
    integration_platforms:
      - nrf52840dk/nrf52840
      - nrf5340dk/nrf5340/cpuapp
      - nrf54l15dk/nrf54l15/cpuapp
    extra_configs:
      - CONFIG_DEPRECATED_SIDEWALK_MFG_STORAGE=y
```

## tests/functional/pal_delay/testcase.yaml
```yaml
tests:
  sidewalk.functional.delay:
    sysbuild: true
    platform_allow:
      - nrf52840dk/nrf52840
      - nrf5340dk/nrf5340/cpuapp
      - nrf54l15dk/nrf54l15/cpuapp
      - nrf54l15dk/nrf54l15/cpuapp/ns
    integration_platforms:
      - nrf52840dk/nrf52840
      - nrf5340dk/nrf5340/cpuapp
      - nrf54l15dk/nrf54l15/cpuapp
      - nrf54l15dk/nrf54l15/cpuapp/ns
    tags: Sidewalk
```

## tests/functional/spi_bus/testcase.yaml
```yaml
tests:
  sidewalk.functional.spi_bus:
    platform_allow: nrf52840dk/nrf52840 nrf5340dk/nrf5340/cpuapp nrf54l15pdk/nrf54l15/cpuapp
    integration_platforms:
      - nrf52840dk/nrf52840
      - nrf5340dk/nrf5340/cpuapp
      - nrf54l15pdk/nrf54l15/cpuapp
    tags: Sidewalk
    # harness: ztest
    # harness_config:
    #   fixture: semtech_shield
```

## tests/functional/spi_endless/testcase.yaml
```yaml
common:
  depends_on: spi
  tags: drivers spi ci_tests_benchmarks_spi_endless
  harness: console
  harness_config:
    fixture: gpio_spi_bridge_two_boards
  build_only: true
  platform_allow:
    - nrf52840dk/nrf52840
    - nrf54l15dk/nrf54l15/cpuapp
  integration_platforms:
    - nrf54l15dk/nrf54l15/cpuapp

tests:
  drivers.spi.spi_endless.host:
    extra_configs:
      - CONFIG_ROLE_HOST=1

  # drivers.spi.spi_endless.host.4mhz:
  #   extra_configs:
  #     - CONFIG_ROLE_HOST=1
  #   extra_args: EXTRA_DTC_OVERLAY_FILE="boards/4mhz.overlay"

  # drivers.spi.spi_endless.host.2mhz:
  #   extra_configs:
  #     - CONFIG_ROLE_HOST=1
  #   extra_args: EXTRA_DTC_OVERLAY_FILE="boards/2mhz.overlay"

  # drivers.spi.spi_endless.host.1mhz:
  #   extra_configs:
  #     - CONFIG_ROLE_HOST=1
  #   extra_args: EXTRA_DTC_OVERLAY_FILE="boards/1mhz.overlay"

  drivers.spi.spi_endless.device:
    extra_configs:
      - CONFIG_ROLE_HOST=0
```

## tests/functional/storage/testcase.yaml
```yaml
tests:
  sidewalk.functional.storage:
    sysbuild: true
    tags: Sidewalk
    platform_allow:
      - nrf52840dk/nrf52840
      - nrf5340dk/nrf5340/cpuapp
      - nrf54l15dk/nrf54l15/cpuapp
      - nrf54l15dk/nrf54l15/cpuapp/ns
    integration_platforms:
      - nrf52840dk/nrf52840
      - nrf5340dk/nrf5340/cpuapp
      - nrf54l15dk/nrf54l15/cpuapp
      - nrf54l15dk/nrf54l15/cpuapp/ns
```

## tests/functional/temperature/testcase.yaml
```yaml
tests:
  sidewalk.functional.temperature:
    platform_allow:
      - nrf52840dk/nrf52840
      - nrf5340dk/nrf5340/cpuapp
      # - nrf54l15pdk@0.3.0/nrf54l15/cpuapp temperature sensor not working
    integration_platforms:
      - nrf52840dk/nrf52840
      - nrf5340dk/nrf5340/cpuapp
      # - nrf54l15pdk@0.3.0/nrf54l15/cpuapp temperature sensor not working
    tags: Sidewalk
```

## tests/functional/testcase.yaml
```yaml
tests:
  unity.sidewalk.functional:
    tags: Sidewalk
    platform_allow: nrf52840dk_nrf52840
    integration_platforms:
      - nrf52840dk_nrf52840
```

## tests/functional/time/testcase.yaml
```yaml
tests:
  sidewalk.functional.time:
    sysbuild: true
    tags: Sidewalk
    platform_allow: nrf52840dk/nrf52840 nrf5340dk/nrf5340/cpuapp
    integration_platforms:
      - nrf52840dk/nrf52840
      - nrf5340dk/nrf5340/cpuapp
```

## tests/integration/critical_region/testcase.yaml
```yaml
tests:
  sidewalk.test.integration.critical_region:
    sysbuild: true
    tags: Sidewalk
    platform_allow:
      - native_sim
      - nrf54l15dk/nrf54l15/cpuapp
      - nrf54l15dk/nrf54l10/cpuapp
      - nrf52840dk/nrf52840
    integration_platforms:
      - nrf54l15dk/nrf54l15/cpuapp
```

## tests/integration/crypto_keys/Kconfig
```kconfig
#
# Copyright (c) 2022 Nordic Semiconductor ASA
#
# SPDX-License-Identifier: LicenseRef-Nordic-5-Clause
#
config SIDEWALK_BUILD
	default y

config SIDEWALK_USE_PREBUILT_LIBRARIES
	default y


config SIDEWALK_CRYPTO
	default y

config SIDEWALK_STORAGE
	default y

config SIDEWALK_SETTINGS_UTILS
	default y

config SIDEWALK_CRYPTO_PSA_KEY_STORAGE
	default y

config SIDEWALK_CRYPTO_PSA_KEY_STORAGE_KMU
	bool "Store persistent Sidewalk keys in nRF54L KMU"
	default y

config SIDEWALK_CRYPTO_PSA_KEY_STORAGE_KMU_SLOT_START
	depends on SIDEWALK_CRYPTO_PSA_KEY_STORAGE_KMU
	default 173

config SIDEWALK_CRYPTO_LOG_LEVEL
	default 0

config SIDEWALK_LOG
	default y
	imply LOG

config SIDEWALK_LOG_LEVEL
	default 0

config SIDEWALK_LOG_MSG_LENGTH_MAX
	default 80


config NVS_LOG_LEVEL
	default 0

config ZMS_LOG_LEVEL
	default 0

# Stacks
config MAIN_STACK_SIZE
	default 8192

config ZTEST_STACK_SIZE
	default 8192

config HEAP_MEM_POOL_SIZE
	default 4096

config MBEDTLS_HEAP_SIZE
	default 4096

rsource "Kconfig.defconfig"
source "Kconfig.zephyr"
source "${ZEPHYR_BASE}/../sidewalk/Kconfig.dependencies"
```

## tests/integration/crypto_keys/Kconfig.defconfig
```kconfig
#
# Copyright (c) 2024 Nordic Semiconductor ASA
#
# SPDX-License-Identifier: LicenseRef-Nordic-5-Clause
#

config PSA_USE_CC3XX_KEY_AGREEMENT_DRIVER
	default n if SOC_NRF52840 || SOC_NRF5340_CPUAPP

config PSA_USE_CC3XX_ASYMMETRIC_SIGNATURE_DRIVER
	default n if SOC_NRF52840 || SOC_NRF5340_CPUAPP

config PSA_USE_CC3XX_ASYMMETRIC_ENCRYPTION_DRIVER
	default n if SOC_NRF52840 || SOC_NRF5340_CPUAPP

config PSA_USE_CC3XX_KEY_MANAGEMENT_DRIVER
	default n if SOC_NRF52840 || SOC_NRF5340_CPUAPP
```

## tests/integration/crypto_keys/testcase.yaml
```yaml
tests:
  sidewalk.test.integration.crypto_keys:
    sysbuild: true
    tags: Sidewalk
    platform_allow:
      - nrf54l15dk/nrf54l15/cpuapp
      - nrf54l15dk/nrf54l10/cpuapp
      - nrf54lv10dk/nrf54lv10a/cpuapp
      - nrf54lm20dk/nrf54lm20a/cpuapp
      - nrf54lm20dk/nrf54lm20b/cpuapp
    integration_platforms:
      - nrf54l15dk/nrf54l15/cpuapp

  sidewalk.test.integration.crypto_keys.no_kmu:
    sysbuild: true
    tags: Sidewalk
    platform_allow:
      - nrf54l15dk/nrf54l15/cpuapp
      - nrf54l15dk/nrf54l10/cpuapp
      - nrf54lv10dk/nrf54lv10a/cpuapp
      - nrf54lm20dk/nrf54lm20a/cpuapp
      - nrf54lm20dk/nrf54lm20b/cpuapp
    integration_platforms:
      - nrf54l15dk/nrf54l15/cpuapp
    extra_configs:
      - CONFIG_SIDEWALK_CRYPTO_PSA_KEY_STORAGE_KMU=n
```

## tests/integration/mfg/testcase.yaml
```yaml
tests:
  sidewalk.test.integration.mfg:
    sysbuild: true
    tags: Sidewalk
    platform_allow:
      - nrf54l15dk/nrf54l15/cpuapp
      - nrf54l15dk/nrf54l10/cpuapp
      - nrf52840dk/nrf52840
    integration_platforms:
      - nrf54l15dk/nrf54l15/cpuapp
```

## tests/integration/spi/Kconfig
```kconfig
#
# Copyright (c) 2022 Nordic Semiconductor ASA
#
# SPDX-License-Identifier: LicenseRef-Nordic-5-Clause
#
config SIDEWALK_BUILD
	default y

config SIDEWALK_USE_PREBUILTS
	default y

config SIDEWALK_SUBGHZ_SUPPORT
	default y

config SIDEWALK_TEMPERATURE
	default n

config SIDEWALK_SUBGHZ_TRIM_CAP_VAL
	hex "value for trim cap used by subGHz radio"
	range 0x0 0xFFFF
	default 0x1212

config SIDEWALK_SPI_BUS
	default y

config SIDEWALK_GPIO
	default y

config SIDEWALK_GPIO_MAX
	default 6

config SIDEWALK_GPIO_IRQ_PRIORITY
	default 1

config SIDEWALK_GPIO_IRQ_STACK_SIZE
	default 2048

config SIDEWALK_LOG_LEVEL
	default 0

config SPI_BUS_LOG_LEVEL
	default 0

source "Kconfig.zephyr"
source "${ZEPHYR_BASE}/../sidewalk/Kconfig.dependencies"
```

## tests/integration/spi/boards/nrf54l15dk_nrf54l15_cpuapp_ns.conf
```kconfig
#
# Copyright (c) 2024 Nordic Semiconductor ASA
#
# SPDX-License-Identifier: LicenseRef-Nordic-5-Clause
#

# Disable tf-m uart to reuse pins for semtech
CONFIG_TFM_LOG_LEVEL_SILENCE=y
CONFIG_TFM_SECURE_UART=n
```
