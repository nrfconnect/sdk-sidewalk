## samples/common/Kconfig.defconfig
```kconfig
#
# Copyright (c) 2022 Nordic Semiconductor ASA
#
# SPDX-License-Identifier: LicenseRef-Nordic-4-Clause
#
mainmenu "Sidewalk nRF Connect Application"

# Crypto
config PSA_CRYPTO_DRIVER_ALG_ECDSA_CC3XX
	default n

# Bluetooth
config BT_REMOTE_VERSION
	default y

config BT_BUF_ACL_TX_SIZE
	default 251
	default 502 if SIDEWALK_DFU_BLE_FAST

config BT_BUF_ACL_TX_COUNT
	default 3

config BT_BUF_ACL_RX_SIZE
	default 251
	default 502 if SIDEWALK_DFU_BLE_FAST

config BT_BUF_ACL_RX_COUNT
	default 6

config BT_L2CAP_TX_MTU
	default 247
	default 498 if SIDEWALK_DFU_BLE_FAST

config BT_CTLR_DATA_LENGTH_MAX
	default 247
	default 251 if SIDEWALK_DFU_BLE_FAST

config BT_PERIPHERAL_PREF_MIN_INT
	default 16

config BT_PERIPHERAL_PREF_MAX_INT
	default 60

config BT_PERIPHERAL_PREF_LATENCY
	default 0

config BT_PERIPHERAL_PREF_TIMEOUT
	default 400

# Stack and Heap
config SYSTEM_WORKQUEUE_STACK_SIZE
    default 4096 if SIDEWALK_LINK_MASK_LORA || SIDEWALK_LINK_MASK_FSK
	default 4096 if SIDEWALK_DFU_SERVICE_BLE

config LOG_PROCESS_THREAD_STARTUP_DELAY_MS
	default 50 if SHELL

config SHELL_STACK_SIZE
	default 8192 if SIDEWALK_CLI

config HEAP_MEM_POOL_SIZE
	default 1024
```

## samples/common/Kconfig.mcuboot.defaults
```kconfig
#
# Copyright (c) 2022 Nordic Semiconductor ASA
#
# SPDX-License-Identifier: LicenseRef-Nordic-5-Clause
#

# The purpose of this file is to define new default values of settings used when building mcuboot child image for Sidewalk samples.

config MAIN_STACK_SIZE
    default 10240

config BOOT_SWAP_SAVE_ENCTLV
    default n

config BOOT_ENCRYPT_RSA
    default n

config BOOT_ENCRYPT_EC256
    default n

config BOOT_ENCRYPT_X25519
    default n

config BOOT_BOOTSTRAP
    default n

config PM
    default n

config FLASH
    default y

config FPROTECT
    default y

config BOOT_MAX_IMG_SECTORS
    default 256 if NORDIC_QSPI_NOR
    default 128

config MINIMAL_LIBC_CALLOC
    default y

config MINIMAL_LIBC_MALLOC
    default y

config MINIMAL_LIBC_REALLOCARRAY
    default y

config NCS_SAMPLES_DEFAULTS
    default n

config NRF_RTC_TIMER
    default y if SOC_SERIES_NRF53X
    default n

config GPIO
    default n

config KERNEL_MEM_POOL
    default n

config TIMESLICING
    default n

config SECURE_BOOT_DEBUG
    default n

config MULTITHREADING
    default n

config TICKLESS_KERNEL
    default n

config TIMEOUT_64BIT
    default n

config NRF_ENABLE_ICACHE
    default n
```

## samples/common/Kconfig.mcuboot.external_flash
```kconfig
#
# Copyright (c) 2022 Nordic Semiconductor ASA
#
# SPDX-License-Identifier: LicenseRef-Nordic-5-Clause
#

config NORDIC_QSPI_NOR
    default y

config NORDIC_QSPI_NOR_FLASH_LAYOUT_PAGE_SIZE
    default 4096

config NORDIC_QSPI_NOR_STACK_WRITE_BUFFER_SIZE
    default 16
```

## samples/common/Kconfig.mcuboot.external_flash.defaults
```kconfig
#
# Copyright (c) 2022 Nordic Semiconductor ASA
#
# SPDX-License-Identifier: LicenseRef-Nordic-5-Clause
#
# The purpose of this file is to define new default values of settings used when building mcuboot child image for Sidewalk samples.

config MAIN_STACK_SIZE
    default 10240

config BOOT_SWAP_SAVE_ENCTLV
    default n

config BOOT_ENCRYPT_RSA
    default n

config BOOT_ENCRYPT_EC256
    default n

config BOOT_ENCRYPT_X25519
    default n

config BOOT_BOOTSTRAP
    default n

config PM
    default n

config FLASH
    default y

config FPROTECT
    default y

config NORDIC_QSPI_NOR
    default y

config NORDIC_QSPI_NOR_FLASH_LAYOUT_PAGE_SIZE
    default 4096

config NORDIC_QSPI_NOR_STACK_WRITE_BUFFER_SIZE
    default 16

config BOOT_MAX_IMG_SECTORS
    default 256

config LOG
    default n

choice LIBC_IMPLEMENTATION
	default MINIMAL_LIBC
endchoice

config COMMON_LIBC_CALLOC
    default y

config COMMON_LIBC_MALLOC
    default y

config COMMON_LIBC_REALLOCARRAY
    default y

config NCS_SAMPLES_DEFAULTS
    default n

config PRINTK
    default n

config REBOOT
    default n

config NRF_RTC_TIMER
    default y if SOC_SERIES_NRF53X
    default n

config CONSOLE
    default n

config CONSOLE_HANDLER
    default n

config GPIO
    default n

config KERNEL_MEM_POOL
    default n

config ASSERT
    default n

config BOOT_BANNER
    default n

config SERIAL
    default n

config UART_CONSOLE
    default n

config TIMESLICING
    default n

config USE_SEGGER_RTT
    default n

config RESET_ON_FATAL_ERROR
    default n

config SECURE_BOOT_DEBUG
    default n

config MULTITHREADING
    default n

config TICKLESS_KERNEL
    default n

config TIMEOUT_64BIT
    default n

config NRF_ENABLE_ICACHE
    default n
```

## samples/sid_dut/child_image/hci_rpmsg/Kconfig.root
```kconfig
#
# Copyright (c) 2022 Nordic Semiconductor ASA
#
# SPDX-License-Identifier: LicenseRef-Nordic-5-Clause
#

# The purpose of this file is to create a wrapper Kconfig file that will be set as
# hci_rpmsg_KCONFIG_ROOT and processed before any other Kconfig for hci_rpmsg child image.

rsource "../../../common/Kconfig.hci_rpmsg.defaults"
source "Kconfig.zephyr"
```

## samples/sid_end_device/boards/nrf54l15dk_nrf54l10_cpuapp.conf
```kconfig
#
# Copyright (c) 2024 Nordic Semiconductor ASA
#
# SPDX-License-Identifier: LicenseRef-Nordic-5-Clause
#

CONFIG_POWEROFF=y

# nRF54L15DK uses SPI NOR external flash for DFU
CONFIG_SPI=y
CONFIG_SPI_NOR=y
CONFIG_MULTITHREADING=y
CONFIG_PM_OVERRIDE_EXTERNAL_DRIVER_CHECK=y
CONFIG_MCUMGR_GRP_IMG_ALLOW_ERASE_PENDING=y

# ZMS cache optimization
CONFIG_ZMS_LOOKUP_CACHE=y
CONFIG_ZMS_LOOKUP_CACHE_SIZE=512
CONFIG_ZMS_LOOKUP_CACHE_FOR_SETTINGS=y
```

## samples/sid_end_device/boards/nrf54l15dk_nrf54l15_cpuapp.conf
```kconfig
#
# Copyright (c) 2024 Nordic Semiconductor ASA
#
# SPDX-License-Identifier: LicenseRef-Nordic-5-Clause
#

CONFIG_POWEROFF=y

# ZMS cache optimization
CONFIG_ZMS_LOOKUP_CACHE=y
CONFIG_ZMS_LOOKUP_CACHE_SIZE=512
CONFIG_ZMS_LOOKUP_CACHE_FOR_SETTINGS=y
```

## samples/sid_end_device/boards/nrf54l15dk_nrf54l15_cpuapp_ns.conf
```kconfig
#
# Copyright (c) 2024 Nordic Semiconductor ASA
#
# SPDX-License-Identifier: LicenseRef-Nordic-5-Clause
#

# Multirole is the only currently supported role by SoftDevice.
CONFIG_BT_LL_SOFTDEVICE_MULTIROLE=y

# nRF54L15 requires bigger stack sizes than nRF52/nRF53 families
CONFIG_MPSL_WORK_STACK_SIZE=2048

# Not supported for 54L15 _NS
CONFIG_FPROTECT=n

# Set the ZMS sector count to match the settings partition size that is 40 kB for this application.
CONFIG_SETTINGS_ZMS_SECTOR_COUNT=10

# Disable tf-m uart to reuse pins for semtech
CONFIG_TFM_LOG_LEVEL_SILENCE=y
CONFIG_TFM_SECURE_UART=n
```

## samples/sid_end_device/boards/nrf54l15pdk_nrf54l15_cpuapp_release.conf
```kconfig
#
# Copyright (c) 2024 Nordic Semiconductor ASA
#
# SPDX-License-Identifier: LicenseRef-Nordic-5-Clause
#

# Workaround:
# The nRF54L15 PDK (PCA10156) revisions v0.2.0 AA0-ES2, v0.2.0 AA0-ES3,
# and v0.2.1 AB0-ES5 have Buttons 3 and 4 connected to the GPIO port
# which does not support interrupts.
CONFIG_DK_LIBRARY_BUTTON_NO_ISR=y

CONFIG_SOC_FLASH_NRF_TIMEOUT_MULTIPLIER=100
```

## samples/sid_end_device/boards/nrf54lv10dk_nrf54lv10a_cpuapp.conf
```kconfig
#
# Copyright (c) 2025 Nordic Semiconductor ASA
#
# SPDX-License-Identifier: LicenseRef-Nordic-5-Clause
#

CONFIG_POWEROFF=y

# ZMS cache optimization
CONFIG_ZMS_LOOKUP_CACHE=y
CONFIG_ZMS_LOOKUP_CACHE_SIZE=512
CONFIG_ZMS_LOOKUP_CACHE_FOR_SETTINGS=y

# LTO to fit within RRAM constraints
CONFIG_LTO=y
CONFIG_ISR_TABLES_LOCAL_DECLARATION=y
```

## samples/sid_end_device/boards/rak4631_nrf52840.conf
```kconfig
#
# Copyright (c) 2024 Nordic Semiconductor ASA
# SPDX-License-Identifier: LicenseRef-Nordic-5-Clause

# DFU
CONFIG_SIDEWALK_DFU=n

# Shell and USB CDC console
CONFIG_USB_DEVICE_STACK=y
CONFIG_USB_CDC_ACM=y
CONFIG_USB_CDC_ACM_RINGBUF_SIZE=512
CONFIG_USB_CDC_ACM_LOG_LEVEL_OFF=y
CONFIG_USB_DEVICE_INITIALIZE_AT_BOOT=y
CONFIG_USB_DEVICE_VID=0x2FE9
CONFIG_USB_DEVICE_MANUFACTURER="Nordic"
CONFIG_USB_DEVICE_PRODUCT="Semiconductor_"
CONFIG_SERIAL=y
CONFIG_CONSOLE=y
CONFIG_UART_CONSOLE=y
CONFIG_UART_INTERRUPT_DRIVEN=y
CONFIG_UART_LINE_CTRL=y
CONFIG_UART_INTERRUPT_DRIVEN=y

CONFIG_SHELL=y
CONFIG_SHELL_BACKEND_SERIAL=y
CONFIG_SHELL_BACKEND_SERIAL_CHECK_DTR=y
CONFIG_REBOOT=y
```

## samples/sid_end_device/boards/thingy53_nrf5340_cpuapp.conf
```kconfig
#
# Copyright (c) 2023 Nordic Semiconductor ASA
#
# SPDX-License-Identifier: LicenseRef-Nordic-5-Clause
#
# Allow for storing two images in MCUboot partitions
CONFIG_UPDATEABLE_IMAGE_NUMBER=2

# Store new images inside external flash
CONFIG_PM_EXTERNAL_FLASH_MCUBOOT_SECONDARY=y

# Configure QSPI for external flash
CONFIG_NORDIC_QSPI_NOR=y
CONFIG_NORDIC_QSPI_NOR_FLASH_LAYOUT_PAGE_SIZE=4096
CONFIG_NORDIC_QSPI_NOR_STACK_WRITE_BUFFER_SIZE=16

CONFIG_DFU_MULTI_IMAGE=y
CONFIG_NRF53_ENFORCE_IMAGE_VERSION_EQUALITY=y

CONFIG_I2C=y
CONFIG_SENSOR=y
CONFIG_BME680=y

CONFIG_SIDEWALK_SUBGHZ_SUPPORT=n
```

## samples/sid_end_device/sample.yaml
```yaml
sample:
  name: Sidewalk end device sample
  description: Sample implementing Amazon Sidewalk End Device

common:
  sysbuild: true
  build_only: true
  platform_allow:
    - nrf52840dk/nrf52840
    - nrf5340dk/nrf5340/cpuapp
    - nrf54l15dk/nrf54l15/cpuapp
    - nrf54l15dk/nrf54l15/cpuapp/ns
    - nrf54l15dk/nrf54l10/cpuapp
  integration_platforms:
    - nrf54l15dk/nrf54l15/cpuapp
  tags:
    - Sidewalk

tests:
  sample.sidewalk.hello.sx1262:
    extra_args:
      - OVERLAY_CONFIG="overlay-hello.conf"
      - SHIELD="simple_arduino_adapter;semtech_sx1262mb2cas"
    extra_configs:
      - CONFIG_SID_END_DEVICE_PERSISTENT_LINK_MASK=y
      - CONFIG_SIDEWALK_FILE_TRANSFER=y
      - CONFIG_SIDEWALK_APPLICATION_NAME="hello"
    tags:
      - hello
      - sx1262

  sample.sidewalk.hello.lr1110:
    build_only: false
    platform_exclude:
      - nrf5340dk/nrf5340/cpuapp
    extra_args:
      - OVERLAY_CONFIG="overlay-hello.conf"
      - SHIELD="simple_arduino_adapter;semtech_lr1110mb1xxs"
    extra_configs:
      - CONFIG_SID_END_DEVICE_PERSISTENT_LINK_MASK=y
      - CONFIG_SIDEWALK_FILE_TRANSFER=y
      - CONFIG_SIDEWALK_APPLICATION_NAME="hello"
    harness: console
    harness_config:
      type: multi_line
      regex:
        - ".*Booting Sidewalk.*"
    tags:
      - hello
      - lr1110

  sample.sidewalk.hello.release.sx1262:
    extra_args:
      - FILE_SUFFIX=release
      - OVERLAY_CONFIG="overlay-hello.conf"
      - SHIELD="simple_arduino_adapter;semtech_sx1262mb2cas"
    extra_configs:
      - CONFIG_SID_END_DEVICE_PERSISTENT_LINK_MASK=y
      - CONFIG_SIDEWALK_APPLICATION_NAME="hello.release"
    tags:
      - hello
      - sx1262

  sample.sidewalk.hello.release.lr1110:
    platform_exclude:
      - nrf5340dk/nrf5340/cpuapp
    extra_args:
      - FILE_SUFFIX=release
      - OVERLAY_CONFIG="overlay-hello.conf"
      - SHIELD="simple_arduino_adapter;semtech_lr1110mb1xxs"

    extra_configs:
      - CONFIG_SID_END_DEVICE_PERSISTENT_LINK_MASK=y
      - CONFIG_SIDEWALK_APPLICATION_NAME="hello.release"
    tags:
      - hello
      - lr1110

  sample.sidewalk.hello.ble_only:
    build_only: false
    platform_allow:
      - nrf54lv10dk/nrf54lv10a/cpuapp
      - nrf54lm20dk/nrf54lm20a/cpuapp
    extra_configs:
      - CONFIG_SIDEWALK_APPLICATION_NAME="hello.ble_only"
    harness: console
    harness_config:
      type: multi_line
      regex:
        - ".*Booting Sidewalk.*"
    tags:
      - hello
      - BLE

  sample.sidewalk.hello.ble_only.release:
    platform_allow:
      - nrf54lv10dk/nrf54lv10a/cpuapp
      - nrf54lm20dk/nrf54lm20a/cpuapp
    extra_args: FILE_SUFFIX=release
    extra_configs:
      - CONFIG_SIDEWALK_APPLICATION_NAME="hello.ble_only.release"
    tags:
      - hello
      - BLE

  sample.sidewalk.demo.sx1262:
    extra_args:
      - OVERLAY_CONFIG="overlay-demo.conf"
      - SHIELD="simple_arduino_adapter;semtech_sx1262mb2cas"
    extra_configs:
      - CONFIG_SID_END_DEVICE_PERSISTENT_LINK_MASK=y
      - CONFIG_SIDEWALK_APPLICATION_NAME="demo"
    tags:
      - demo
      - sx1262

  sample.sidewalk.demo.lr1110:
    platform_exclude:
      - nrf5340dk/nrf5340/cpuapp
    extra_args:
      - OVERLAY_CONFIG="overlay-demo.conf"
      - SHIELD="simple_arduino_adapter;semtech_lr1110mb1xxs"
    extra_configs:
      - CONFIG_SID_END_DEVICE_PERSISTENT_LINK_MASK=y
      - CONFIG_SIDEWALK_APPLICATION_NAME="demo"
    tags:
      - demo
      - lr1110

  sample.sidewalk.demo.ble_only:
    platform_allow:
      - thingy53/nrf5340/cpuapp
    extra_args: OVERLAY_CONFIG="overlay-demo.conf"
    extra_configs:
      - CONFIG_SIDEWALK_APPLICATION_NAME="demo.ble_only"
    integration_platforms:
      - thingy53/nrf5340/cpuapp
    tags:
      - demo
      - BLE

  sample.sidewalk.dut.sx1262:
    extra_args:
      - OVERLAY_CONFIG="overlay-dut.conf"
      - SHIELD="simple_arduino_adapter;semtech_sx1262mb2cas"
    extra_configs:
      - CONFIG_SIDEWALK_APPLICATION_NAME="dut"
    tags:
      - cli
      - sx1262

  sample.sidewalk.dut.lr1110:
    build_only: false
    platform_exclude:
      - nrf5340dk/nrf5340/cpuapp
      - nrf54l15dk/nrf54l15/cpuapp/ns
    integration_platforms:
      - nrf52840dk/nrf52840
    extra_args:
      - OVERLAY_CONFIG="overlay-dut.conf"
      - SHIELD="simple_arduino_adapter;semtech_lr1110mb1xxs"
    extra_configs:
      - CONFIG_SIDEWALK_APPLICATION_NAME="dut"
    harness: console
    harness_config:
      type: multi_line
      regex:
        - "uart:~\\$"
    tags:
      - cli
      - lr1110

  sample.sidewalk.dut.ble_only:
    build_only: false
    platform_allow:
      - nrf54lv10dk/nrf54lv10a/cpuapp
      - nrf54lm20dk/nrf54lm20a/cpuapp
    extra_args: OVERLAY_CONFIG="overlay-dut.conf"
    extra_configs:
      - CONFIG_SIDEWALK_APPLICATION_NAME="dut.ble_only"
    harness: console
    harness_config:
      type: multi_line
      regex:
        - "uart:~\\$"
    tags:
      - cli
      - BLE

  sample.sidewalk.dut.no_secure:
    integration_platforms:
      - nrf52840dk/nrf52840
    extra_args:
      - OVERLAY_CONFIG="overlay-dut.conf"
      - SHIELD="simple_arduino_adapter;semtech_sx1262mb2cas"
    extra_configs:
      - CONFIG_SIDEWALK_CRYPTO_PSA_KEY_STORAGE=n
      - CONFIG_SIDEWALK_APPLICATION_NAME="dut.no_secure"
    tags:
      - cli
      - no_secure

  sample.sidewalk.helloPower.ble.release:
    platform_allow:
      - nrf54lv10dk/nrf54lv10a/cpuapp
      - nrf54lm20dk/nrf54lm20a/cpuapp
    extra_args: FILE_SUFFIX=release
    extra_configs:
      - CONFIG_STATE_NOTIFIER=n
      - CONFIG_SIDEWALK_LINK_MASK_BLE=y
      - CONFIG_SIDEWALK_APPLICATION_NAME="helloPower.release.ble"
    tags:
      - helloPower

  sample.sidewalk.helloPower.fsk.release.sx1262:
    extra_args:
      - FILE_SUFFIX=release
      - SHIELD="simple_arduino_adapter;semtech_sx1262mb2cas"
    extra_configs:
      - CONFIG_STATE_NOTIFIER=n
      - CONFIG_SIDEWALK_LINK_MASK_FSK=y
      - CONFIG_SIDEWALK_APPLICATION_NAME="helloPower.release.fsk"
    tags:
      - helloPower
      - sx1262

  sample.sidewalk.helloPower.lora.release.sx1262:
    extra_args:
      - FILE_SUFFIX=release
      - SHIELD="simple_arduino_adapter;semtech_sx1262mb2cas"
    extra_configs:
      - CONFIG_STATE_NOTIFIER=n
      - CONFIG_SIDEWALK_LINK_MASK_LORA=y
      - CONFIG_SIDEWALK_APPLICATION_NAME="helloPower.release.lora"
    tags:
      - helloPower
      - sx1262

  sample.sidewalk.helloPower.ble_only.release:
    platform_allow:
      - nrf54lv10dk/nrf54lv10a/cpuapp
      - nrf54lm20dk/nrf54lm20a/cpuapp
    extra_args: FILE_SUFFIX=release
    extra_configs:
      - CONFIG_STATE_NOTIFIER=n
      - CONFIG_SIDEWALK_APPLICATION_NAME="helloPower.ble_only.release"
    tags:
      - helloPower
      - BLE
```
