## Kconfig
```kconfig
#
# Copyright (c) 2023 Nordic Semiconductor ASA
#
# SPDX-License-Identifier: LicenseRef-Nordic-5-Clause
#

menuconfig SIDEWALK
	bool "Amazon Sidewalk support"
	imply SIDEWALK_DFU

if SIDEWALK

# General
config MAIN_STACK_SIZE
	default 2048

DT_CHOSEN_Z_LORA_TRANSCEIVER := zephyr,lora-transceiver

config SIDEWALK_SUBGHZ_SUPPORT
	bool "Sub-GHz link type support in Sidewalk libraries"
	default y if $(dt_chosen_enabled,$(DT_CHOSEN_Z_LORA_TRANSCEIVER))
	help
	  Use Sidewalk with support for BLE, LoRa and FSK.

if SIDEWALK_SUBGHZ_SUPPORT

choice SIDEWALK_SUBGHZ_RADIO
	prompt "Sub-GHz radio type"
	default SIDEWALK_SUBGHZ_RADIO_SX126X if SHIELD_SEMTECH_SX126xMB2xxS
	default SIDEWALK_SUBGHZ_RADIO_LR1110 if SHIELD_SEMTECH_LR1110MB1xxS || SHIELD_NRF_SIDEWALK_EB
	help
	  Choose the sub-GHz radio type for Sidewalk.

config SIDEWALK_SUBGHZ_RADIO_SX126X
	bool "Semtech SX126X"

config SIDEWALK_SUBGHZ_RADIO_LR1110
	bool "Semtech LR1110"

endchoice # SIDEWALK_SUBGHZ_RADIO

config SIDEWALK_SUBGHZ_TRIM_CAP_VAL
	hex "value for trim cap used by subGHz radio"
	range 0x0 0xFFFF
	default 0x1212
	help
	  The value of the trim cap. Default value works for Semtech SX1262 shield.

endif # SIDEWALK_SUBGHZ_SUPPORT

choice SIDEWALK_LINK_MASK
	prompt "Physical link type"
	default SIDEWALK_LINK_MASK_BLE
	help
	  Choose the default physical link type for Sidewalk connection.

config SIDEWALK_LINK_MASK_BLE
	bool "Bluetooth Low Energy link"

config SIDEWALK_LINK_MASK_FSK
	bool "Sub-GHz link for FSK"

config SIDEWALK_LINK_MASK_LORA
	bool "Sub-GHz link for LORA"

endchoice # SIDEWALK_LINK_MASK

config SIDEWALK_THREAD_STACK_SIZE
	int "Stack size for the Sidewalk thread"
	range 8192 131072
	default 8192
	help
	  Set the internal stack size for Sidewalk thread.

config SIDEWALK_THREAD_QUEUE_SIZE
	int "Message queue size for the Sidewalk thread"
	range 4 256
	default 64
	help
	  Set the message queue size for the Sidewalk thread.

config SIDEWALK_THREAD_QUEUE_TIMEOUT_VALUE
	int "Message queue timeout value in ms"
	default 300

config SIDEWALK_THREAD_PRIORITY
	int "Priority of the Sidewalk thread"
	range -16 14
	default 14
	help
	  Priority at which the Sidewalk thread runs.

config SIDEWALK_HEAP_SIZE
	int "Heap size for Sidewalk utils"
	default 5120 if SIDEWALK_ACE_OSAL_ZEPHYR
	default 4096
	help
	  Set the heap size for dynamic memory alocation in Sidewalk.

config SIDEWALK_TRACE_HEAP
	bool "Trace allocation and free of Sidewalk heap"
	help
	  Add debug log to every alloc and free operation on Sidewalk heap.

config SID_HAL_PROTOCOL_MEMORY_SZ
	int
	default 1024

config SIDEWALK_APPLICATION_NAME
	string "Name of the application printed on start up"
	default "sidewalk"
	help
	  To help with identification of the run sample the application name can be set up.
	  This information will be printed on startup next to version of the components used.  

# Log
config SIDEWALK_LOG_MSG_LENGTH_MAX
	int "Log message max length"
	default 80
	help
	  Maxium message length for Sidewalk PAL log in bytes.

module = SIDEWALK
module-str = Amazon Sidewalk
source "${ZEPHYR_BASE}/subsys/logging/Kconfig.template.log_config"

module = SIDEWALK_CRYPTO
module-str = Amazon Sidewalk Crypto
source "${ZEPHYR_BASE}/subsys/logging/Kconfig.template.log_config"

module = SIDEWALK_BLE_ADAPTER
module-str = Sidewalk BLE interface
source "${ZEPHYR_BASE}/subsys/logging/Kconfig.template.log_config"

module = SPI_BUS
module-str = Sidewalk spi bus interface
source "${ZEPHYR_BASE}/subsys/logging/Kconfig.template.log_config"

config DEPRECATED_SIDEWALK_PAL_INIT
	bool "Sidewalk platform init module [DEPRECATED]"
	help
	  Sidewalk 1.16 stack introduces new sid api sid_platform_init.
	  Now new api togehter with sid_common pal are used by default.
	  This implementation is DEPRECATED.

# BLE
config SIDEWALK_BLE_NAME
	string "BLE name advertised for Sidewalk"
	default "SID_APP"

config SIDEWALK_BLE_ADV_INT_PRECISION
	int "Precision of advertisement interval in ms"
	range 1 1000
	default 5

config SIDEWALK_BLE_ADV_INT_FAST
	int "Fast advertise interval in ms"
	range 20 10240
	default 160

config SIDEWALK_BLE_ADV_INT_SLOW
	int "Slow advertise interval in ms"
	range 20 10240
	default 1000

config SIDEWALK_BLE_ADV_INT_TRANSITION
	int "Duration of fast advertisement after sid_start in seconds"
	range 1 2147483647
	default 30

config SIDEWALK_VENDOR_SERVICE
	bool "Sidewalk BLE vendor service"

config SIDEWALK_LOGGING_SERVICE
	bool "Sidewalk BLE logging service"

config SIDEWALK_DEMO_PARSER
	bool "Sensor monitoring demo parser module"

config SIDEWALK_ON_DEV_CERT
	bool "Sidewalk on device certification"
	depends on SHELL

config DEPRECATED_SIDEWALK_MFG_STORAGE
	bool "Previous implementation of manufacturing module [DEPRECATED]"
	imply FLASH
	help
	  Previous Sidewalk manufacturing storage module
	  This implementation is DEPRECATED.

config SIDEWALK_MFG_STORAGE_SUPPORT_HEX_v7
	bool "Support for old Sidewalk manufacturing hex format"
	default y
	depends on SIDEWALK_MFG_STORAGE
	help
	  Sidewalk manifactuing module uses version 8, with tlv format
	  Old fromats - version7 and before, are based on memory offsets
	  and will be supported after enabling this configuration.

config SIDEWALK_CRYPTO_PSA_KEY_STORAGE
	bool "PSA crypto storage for persistent Sidewalk keys"
	default SIDEWALK
	help
	  Use secure key storage for persistent Sidewalk keys.
	  Once you flash the firmware with this config enabled,
	  it must be enabled in every subsequent build.
	  Otherwise, the keys will not be found and Sidewalk will not start.

config SIDEWALK_CRYPTO_PSA_KEY_STORAGE_KMU
	bool "Store persistent Sidewalk keys in KMU"
	depends on SIDEWALK_CRYPTO_PSA_KEY_STORAGE
	depends on CRACEN_LIB_KMU
	default y
	help
	  Store persistent Sidewalk PSA keys in the CRACEN Key Management Unit (KMU)
	  instead of the default PSA trusted storage backend.

config SIDEWALK_CRYPTO_PSA_KEY_STORAGE_KMU_SLOT_START
	int "Start of the Sidewalk KMU slot range"
	depends on SIDEWALK_CRYPTO_PSA_KEY_STORAGE_KMU
	range 0 173
	default 173
	help
	  First KMU slot used by Sidewalk persistent keys. Sidewalk reserves five
	  consecutive key IDs starting from this value. Some keys span multiple
	  KMU slots, so the range occupies seven consecutive KMU slots.

config SIDEWALK_USE_PREBUILT_LIBRARIES
	bool "Use prebuilt Sidewalk libraries"
	default y
	help
		Use prebuilt Sidewalk libraries.
		Building from sources requires additional dependencies,
		not released with nRF Connect SDK.

if SHIELD_NRF7002EB2

config WIFI
	default y

config NETWORKING
	default y

config NET_L2_ETHERNET
	default y

config NET_OFFLOAD
	default y

config WIFI_NRF70
	default y

# NRF70_SCAN_ONLY and NRF_WIFI_PATCHES_EXT_FLASH_DISABLED are choice members
# (NRF70_OPER_MODES / NRF_WIFI_PATCHES_EXT_FLASH_SUPPORT), so the default has
# to be set on the choice itself, not on the member config.
choice NRF70_OPER_MODES
	default NRF70_SCAN_ONLY
endchoice

choice NRF_WIFI_PATCHES_EXT_FLASH_SUPPORT
	default NRF_WIFI_PATCHES_EXT_FLASH_DISABLED
endchoice

endif # SHIELD_NRF7002EB2

config SIDEWALK_WIFI_LOCATION_NRF70
	bool "nRF70 Wi-Fi location PAL"
	depends on WIFI
	default y
	# NETWORKING is already forced on via `if SHIELD_NRF7002EB2` above;
	# selecting it again here would create a WIFI -> NETWORKING -> WIFI
	# Kconfig dependency loop (NETWORKING's select is conditioned on WIFI).
	select NET_MGMT
	select NET_MGMT_EVENT
	select NET_MGMT_EVENT_INFO
	help
	  Provide the Sidewalk Wi-Fi PAL (sid_pal_wifi_ifc.h) backed by an
	  asynchronous Zephyr net_mgmt Wi-Fi scan on the nRF70. This lets the
	  Sidewalk location library drive the Wi-Fi scan by itself
	  (init/schedule_scan/get_scan_payload).

	  When SIDEWALK_SUBGHZ_RADIO_SX126X is also selected this PAL replaces
	  the sx126x_location NOSUPPORT stub, so the (lora_fsk) Sidewalk library
	  actually invokes the Wi-Fi PAL.

	  This PAL can also coexist with SIDEWALK_SUBGHZ_RADIO_LR1110 (for
	  example the nRF Sidewalk EB together with an nRF7002 EB): whenever WIFI
	  is enabled the nRF70 provides the Wi-Fi PAL (taking priority), while the
	  LR1110 keeps providing the GNSS PAL and the sub-GHz radio. When WIFI is
	  disabled the LR1110 provides the Wi-Fi PAL itself.

if SIDEWALK_WIFI_LOCATION_NRF70

config SIDEWALK_WIFI_LOCATION_NRF70_SCAN_TIMEOUT_MS
	int "nRF70 Wi-Fi scan timeout (ms)"
	default 20000
	range 1000 60000
	help
	  Backstop timeout for a single nRF70 Wi-Fi scan. If the net_mgmt
	  scan-done event does not arrive within this window the scan is
	  abandoned and reported as timed out, so the Wi-Fi PAL cannot get
	  stuck busy. Increase it for slow passive or multi-band scans.

choice SIDEWALK_WIFI_LOCATION_NRF70_SCAN_BAND_FILTER
	prompt "nRF70 Wi-Fi location scan band filter"
	# nrf7002eb2 is only verified/tuned for 2.4 GHz so far; other Wi-Fi
	# hardware defaults to scanning both bands.
	default SIDEWALK_WIFI_LOCATION_NRF70_SCAN_BAND_2_4GHZ if SHIELD_NRF7002EB2
	default SIDEWALK_WIFI_LOCATION_NRF70_SCAN_BAND_2_4_AND_5_GHZ
	help
	  Select which Wi-Fi frequency bands the nRF70 location scan covers.
	  Band filtering is applied via wifi_scan_params.bands. See the nRF
	  Connect SDK "Optimizing scan operation" guide for scan time/energy
	  trade-offs per profile.

config SIDEWALK_WIFI_LOCATION_NRF70_SCAN_BAND_2_4GHZ
	bool "2.4 GHz only"
	help
	  Scan only the 2.4 GHz band. Matches the "2.4 GHz Active" profile
	  in the nRF Connect SDK scan optimization guide.

config SIDEWALK_WIFI_LOCATION_NRF70_SCAN_BAND_2_4_AND_5_GHZ
	bool "2.4 and 5 GHz"
	help
	  Scan both the 2.4 GHz and 5 GHz bands. This is the typical profile
	  for Wi-Fi location when dual-band AP visibility is needed.

config SIDEWALK_WIFI_LOCATION_NRF70_SCAN_BAND_ALL
	bool "All regulatory bands (2.4/5/6 GHz)"
	help
	  Do not restrict wifi_scan_params.bands; scan every band the
	  regulatory domain allows.

endchoice

choice SIDEWALK_WIFI_LOCATION_NRF70_SCAN_TYPE
	prompt "nRF70 Wi-Fi location scan type"
	# nrf7002eb2 is only verified/tuned for passive scanning so far; other
	# Wi-Fi hardware defaults to active scanning.
	default SIDEWALK_WIFI_LOCATION_NRF70_SCAN_PASSIVE if SHIELD_NRF7002EB2
	default SIDEWALK_WIFI_LOCATION_NRF70_SCAN_ACTIVE
	help
	  Sets the scan_type hint passed to the driver. It's only a hint -
	  the chip or the regulatory domain can still fall back to passive
	  scanning on channels where active probing isn't allowed (e.g.
	  2.4 GHz channels 12-14). Also make sure
	  CONFIG_WIFI_MGMT_FORCED_PASSIVE_SCAN stays disabled (its default),
	  since it overrides this hint and forces passive scanning on every
	  channel regardless of what you pick here.

config SIDEWALK_WIFI_LOCATION_NRF70_SCAN_ACTIVE
	bool "Active"
	help
	  Sends probe requests (WIFI_SCAN_TYPE_ACTIVE). Faster than passive,
	  but draws more instantaneous transmit power.

config SIDEWALK_WIFI_LOCATION_NRF70_SCAN_PASSIVE
	bool "Passive"
	help
	  Only listens for beacons, no probe requests
	  (WIFI_SCAN_TYPE_PASSIVE). Slower than active, but uses less
	  instantaneous transmit power and works on channels where active
	  probing is restricted.

endchoice

endif # SIDEWALK_WIFI_LOCATION_NRF70

rsource "Kconfig.dependencies"
rsource "utils/Kconfig"
rsource "boards/shields/*/Kconfig.shield"

config LR11XX_CLI
	bool
	help
	  Enables LR11XX CLI-related hooks in Sub-GHz configuration.

config RADIO_LOCK_TEST
	bool
	help
	  Enables radio lock test instrumentation in the LR11XX driver.

config SIDEWALK_MFG_STORAGE_WRITE
	bool
	default n
	help
	  Enables write paths in deprecated manufacturing storage helpers.

endif # SIDEWALK

config SIDEWALK_MFG_PARSER_MAX_ELEMENT_SIZE
	int "Max size of element in MFG"
	default 64
```
