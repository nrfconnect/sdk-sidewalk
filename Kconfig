## Kconfig.dependecies
```kconfig
#
# Copyright (c) 2022 Nordic Semiconductor ASA
#
# SPDX-License-Identifier: LicenseRef-Nordic-5-Clause
#

config SIDEWALK_SUBGHZ
	bool
	default SIDEWALK && (SIDEWALK_LINK_MASK_FSK || SIDEWALK_LINK_MASK_LORA)
	help
	  Use Sidewalk with support for BLE, LoRa and FSK

config SIDEWALK_DEFAULTS
	bool
	default SIDEWALK
	imply REQUIRES_FULL_LIBC
	imply FPU
	imply REBOOT

config SIDEWALK_BUILD
	bool
	default SIDEWALK
	help
	  An internal config to build the NCS Sidewalk Sources.

config SIDEWALK_BLE
	bool
	default SIDEWALK
	imply BT
	imply SETTINGS
	imply BT_PERIPHERAL
	imply BT_GATT_CLIENT
	help 
		Sidewalk Bluetooth Low Energy (BLE) module

config SIDEWALK_ASSERT
	bool
	default SIDEWALK
	imply ASSERT
	help
	  This enables the SID_PAL_ASSERT() macro in the Sidewalk pal code.
	  If the assertion fails, program will trigger a fatal error.

config SIDEWALK_CRYPTO
	bool
	default SIDEWALK
	imply NRF_SECURITY
	imply PSA_CRYPTO_DRIVER_OBERON
	imply PSA_WANT_ALG_HMAC
	imply PSA_WANT_ALG_CTR
	imply PSA_WANT_ALG_GCM
	imply PSA_WANT_ALG_CMAC
	imply PSA_WANT_ALG_SHA_256
	imply PSA_WANT_ALG_ECDH
	imply PSA_WANT_ALG_ECDSA
	imply PSA_WANT_ALG_DETERMINISTIC_ECDSA
	imply PSA_WANT_ALG_STREAM_CIPHER
	imply PSA_WANT_ECC_SECP_R1_256
	imply PSA_WANT_ECC_MONTGOMERY_255
	imply PSA_WANT_ECC_TWISTED_EDWARDS_255
	imply PSA_WANT_KEY_TYPE_AES
	imply PSA_WANT_KEY_TYPE_ECC_KEY_PAIR
	imply PSA_WANT_KEY_TYPE_HMAC
	imply MBEDTLS_PSA_BUILTIN_ALG_CMAC
	imply MBEDTLS_PSA_BUILTIN_ALG_HMAC
	imply MBEDTLS_ENABLE_HEAP
	help
	   Sidewalk security module

config SIDEWALK_LOG
	bool
	default SIDEWALK
	imply LOG
	help
	  Sidewalk log module

config SIDEWALK_GENERATE_VERSION_MINIMAL
	bool
	default SIDEWALK
	help
	  Generate minimal information of application version (sidewalk, zephyr, nrf). 
	  In order to generate full version report from all modules set this config to `N`.

config SIDEWALK_MFG_STORAGE
	bool
	default SIDEWALK
	imply FLASH
	help
	  Sidewalk manufacturing storage module

config SIDEWALK_STORAGE
	bool
	default SIDEWALK
	imply NVS
	imply FLASH
	help
	  Sidewalk storage module

config SIDEWALK_TIMER
	bool
	default SIDEWALK
	help
	  Sidewalk timer module

config SIDEWALK_UPTIME
	bool
	default SIDEWALK
	help
	  Sidewalk uptime module

config SIDEWALK_CRITICAL_REGION
	bool
	default SIDEWALK
	help
	   Sidewalk critical region module

config SIDEWALK_GPIO
	bool
	default SIDEWALK_SUBGHZ
	imply SIDEWALK_LOG
	help
	  Sidewalk GPIO module

config SIDEWALK_ACE_OSAL_ZEPHYR
	bool
	default SIDEWALK
	help
	  Zephyr RTOS abstraction layer for Sidewalk

config SIDEWALK_TEMPERATURE
	bool "Sidewalk temperature module"
	default SIDEWALK_SUBGHZ
	imply SENSOR
	imply TEMP_NRF5
	help
	  Sidewalk temperature module

config SIDEWALK_SW_INTERRUPTS
	bool
	default SIDEWALK
	help
	  Sidewalk software interrupts module

config SIDEWALK_DELAY
	bool
	default SIDEWALK
	help
	  Sidewalk delay module
	
config SIDEWALK_SPI_BUS
	bool
	default SIDEWALK_SUBGHZ
	imply SPI
	imply SIDEWALK_GPIO
	imply PM
	imply PM_DEVICE
	help
	  SPI bus interface for sidewalk

# Hidden configuration (experimental)
config SIDEWALK_SWI_PRIORITY
	int
	default 0

config SIDEWALK_SWI_STACK_SIZE
	int
	default 4096

config SIDEWALK_GPIO_IRQ_PRIORITY
	int
	default 1

config SIDEWALK_GPIO_IRQ_STACK_SIZE
	int
	default 2048

config SIDEWALK_THREAD_TIMER
	bool
	default n

if SIDEWALK_THREAD_TIMER
config SIDEWALK_TIMER_PRIORITY
	int
	default 2

config SIDEWALK_TIMER_STACK_SIZE
	int
	default 2048
endif # Hidden configuration (experimental)

config SIDEWALK_DFU_BOOTLOADER
	bool "Bootloder configuration for Sidewalk sample"
	default SIDEWALK_DFU
	imply IMG_MANAGER
	imply BOOTLOADER_MCUBOOT
	imply FLASH
	imply NET_BUF
	imply ZCBOR
	imply CRC
	imply STREAM_FLASH
	imply FLASH_MAP
	imply MCUMGR_TRANSPORT_BT_REASSEMBLY
	imply FLASH_PAGE_LAYOUT
	imply EXTRA_EXCEPTION_INFO

if SIDEWALK_DFU_SERVICE_BLE

config SIDEWALK_DFU_SERVICE_BLE_DEFAULTS
	bool
	default SIDEWALK_DFU_SERVICE_BLE
	imply MCUMGR
	imply MCUMGR_GRP_IMG
	imply MCUMGR_GRP_OS
	imply MCUMGR_TRANSPORT_BT
	imply MCUMGR_SMP_BT_CONN_PARAM_CONTROL

config MCUMGR_TRANSPORT_BT_AUTHEN
	default n

endif # SIDEWALK_DFU_SERVICE_BLE

if SIDEWALK_DFU_SERVICE_USB

config SIDEWALK_DFU_SERVICE_USB_DEFAULTS
	bool
	default SIDEWALK_DFU_SERVICE_USB
	imply USB_DFU_CLASS
	imply USB_DEVICE_STACK
	imply USB_DFU_ENABLE_UPLOAD
	imply USB_DFU_REBOOT
	imply USB_DC_HAS_HS_SUPPORT

config USB_DEVICE_PRODUCT
	default "DFU for Sidewalk"

config USB_REQUEST_BUFFER_SIZE
	default 8192

config USB_DEVICE_INITIALIZE_AT_BOOT
	default n
	
endif # SIDEWALK_DFU_SERVICE_USB

config UART_1_NRF_UARTE
    default n
```

## Kconfig.dependencies
```kconfig
#
# Copyright (c) 2023 Nordic Semiconductor ASA
#
# SPDX-License-Identifier: LicenseRef-Nordic-5-Clause
#

choice LIBC_IMPLEMENTATION
	default NEWLIB_LIBC
endchoice

config SIDEWALK_DEFAULTS
	bool
	default SIDEWALK
	imply REQUIRES_FULL_LIBC
	imply FPU
	imply REBOOT
	imply PARTITION_MANAGER_ENABLED

if SIDEWALK_DEFAULTS

config SPIN_VALIDATE
    default n

endif # SIDEWALK_DEFAULTS

config SIDEWALK_BUILD
	bool
	default SIDEWALK
	help
	  An internal config to build the NCS Sidewalk Sources.

config SIDEWALK_TFM_SUPPORT
	bool "Sidewalk support for TF-M [EXPERIMENTAL]"
	select EXPERIMENTAL
	default SIDEWALK && BUILD_WITH_TFM

config SIDEWALK_BLE
	bool
	default SIDEWALK
	imply BT
	imply BT_PERIPHERAL
	imply BT_CTLR_CONN_RSSI
	imply BT_CTLR_TX_PWR_DYNAMIC_CONTROL
	imply BT_CTLR_ADVANCED_FEATURES
	imply BT_EXT_ADV
	imply BT_GATT_AUTHORIZATION_CUSTOM
	help
		Sidewalk Bluetooth Low Energy (BLE) module

if SIDEWALK_BLE

config SIDEWALK_BLE_NAME
	string "BLE name adverticed for Sidewalk"
	default "SID_APP"

config BT_ID_MAX
	default 3 if SIDEWALK_DFU
	default 2 

config BT_REMOTE_VERSION
	default y

config BT_BUF_ACL_TX_SIZE
	default 251

config BT_BUF_ACL_TX_COUNT
	default 3

config BT_BUF_ACL_RX_SIZE
	default 251

config BT_BUF_ACL_RX_COUNT_EXTRA
	default 4

config BT_L2CAP_TX_MTU
	default 247

config BT_CTLR_DATA_LENGTH_MAX
	default 247

config BT_PERIPHERAL_PREF_MIN_INT
	default 16

config BT_PERIPHERAL_PREF_MAX_INT
	default 60

config BT_PERIPHERAL_PREF_LATENCY
	default 0

config BT_PERIPHERAL_PREF_TIMEOUT
	default 400

config BT_EXT_ADV_MAX_ADV_SET
	default 2 if SIDEWALK_DFU
	default 1

config BT_MAX_CONN
	default 2 if SIDEWALK_DFU
	default 1

endif # SIDEWALK_BLE

config SIDEWALK_ASSERT
	bool
	default SIDEWALK
	imply ASSERT
	help
	  This enables the SID_PAL_ASSERT() macro in the Sidewalk pal code.
	  If the assertion fails, program will trigger a fatal error.

config SIDEWALK_CRYPTO
	bool
	default SIDEWALK
	imply NRF_SECURITY
	imply HW_CC3XX
	imply PSA_CRYPTO_DRIVER_CC3XX
	imply PSA_WANT_ALG_HMAC
	imply PSA_WANT_ALG_CTR
	imply PSA_WANT_ALG_GCM
	imply PSA_WANT_ALG_CMAC
	imply PSA_WANT_ALG_ECB_NO_PADDING
	imply PSA_WANT_ALG_SHA_256
	imply PSA_WANT_ALG_SHA_512 if SOC_SERIES_NRF54LX
	imply PSA_WANT_ALG_ECDH
	imply PSA_WANT_ALG_ECDSA
	imply PSA_WANT_ALG_DETERMINISTIC_ECDSA
	imply PSA_WANT_ALG_STREAM_CIPHER
	imply PSA_WANT_ALG_CCM
	imply PSA_WANT_ALG_GCM
	imply PSA_WANT_ALG_PURE_EDDSA
	imply PSA_WANT_ECC_SECP_R1_256
	imply PSA_WANT_ECC_MONTGOMERY_255
	imply PSA_WANT_ECC_TWISTED_EDWARDS_255
	imply PSA_WANT_KEY_TYPE_AES
	imply PSA_WANT_KEY_TYPE_ECC_KEY_PAIR_IMPORT
	imply PSA_WANT_KEY_TYPE_ECC_KEY_PAIR_EXPORT
	imply PSA_WANT_KEY_TYPE_ECC_KEY_PAIR_GENERATE
	imply PSA_WANT_KEY_TYPE_HMAC
	imply PSA_WANT_GENERATE_RANDOM
	imply MBEDTLS_ENABLE_HEAP
	help
	   Sidewalk security module

config SIDEWALK_SECURE_KEY
	bool
	default SIDEWALK_CRYPTO_PSA_KEY_STORAGE
	imply MBEDTLS_PSA_CRYPTO_STORAGE_C
	imply TRUSTED_STORAGE if !BUILD_WITH_TFM
	imply HW_UNIQUE_KEY if !BUILD_WITH_TFM
	imply HW_UNIQUE_KEY_RANDOM if !BUILD_WITH_TFM
	imply HW_UNIQUE_KEY_WRITE_ON_CRYPTO_INIT if !BUILD_WITH_TFM
	imply TFM_ITS_ENCRYPTED if BUILD_WITH_TFM
	help
	  Sidewalk persistent keys storage module

config SIDEWALK_LOG
	bool
	default SIDEWALK
	imply LOG
	help
	  Sidewalk log module

if SIDEWALK_LOG


config NVS_LOG_LEVEL
	depends on NVS
	default 2

config ZMS_LOG_LEVEL
	depends on ZMS
	default 2

endif # SIDEWALK_LOG

config SIDEWALK_MFG_STORAGE
	bool
	default SIDEWALK && !DEPRECATED_SIDEWALK_MFG_STORAGE
	imply FLASH
	imply FPROTECT
	imply SIDEWALK_TLV
	imply SIDEWALK_TLV_FLASH
	imply SIDEWALK_TLV_RAM
	help
	  Sidewalk manufacturing storage module
	  Supports: tlv parser, secure key storage and memory protection

config SIDEWALK_MFG_STORAGE_DIAGNOSTIC
	bool
	default SIDEWALK_ON_DEV_CERT
	depends on SIDEWALK_MFG_STORAGE || DEPRECATED_SIDEWALK_MFG_STORAGE
	help
	  Enable mfg storage diagnostic functionalities

config SIDEWALK_STORAGE
	bool
	default SIDEWALK
	imply NVS if !SOC_FLASH_NRF_RRAM
	imply NVS_LOOKUP_CACHE if !SOC_FLASH_NRF_RRAM
	imply NVS_LOOKUP_CACHE_FOR_SETTINGS if !SOC_FLASH_NRF_RRAM
	imply ZMS if SOC_FLASH_NRF_RRAM
	imply ZMS_LOOKUP_CACHE if SOC_FLASH_NRF_RRAM
	imply ZMS_LOOKUP_CACHE_FOR_SETTINGS if SOC_FLASH_NRF_RRAM
	imply FLASH_MAP
	imply FLASH
	imply SETTINGS
	help
	  Sidewalk storage module

if SIDEWALK_STORAGE

config NVS_LOOKUP_CACHE_SIZE
    default 256 if NVS

config ZMS_LOOKUP_CACHE_SIZE
    default 256 if ZMS

endif # SIDEWALK_STORAGE

config SIDEWALK_TIMER
	bool
	default SIDEWALK
	imply SIDEWALK_UPTIME
	imply SIDEWALK_CRITICAL_REGION
	help
	  Sidewalk timer module

config SIDEWALK_UPTIME
	bool
	default SIDEWALK
	help
	  Sidewalk uptime module

config SIDEWALK_CRITICAL_REGION
	bool
	default SIDEWALK
	help
	   Sidewalk critical region module

if SIDEWALK_CRITICAL_REGION

config SIDEWALK_CRITICAL_REGION_RE_ENTRY_MAX
	int
	default 8
	help
	  Maximum nesting level of critical region
	  If the nesting level becomes greater than set by this config, assert will be triggered.

endif # SIDEWALK_CRITICAL_REGION

config SIDEWALK_GPIO
	bool
	default SIDEWALK_SUBGHZ_SUPPORT
	imply SIDEWALK_LOG
	help
	  Sidewalk GPIO module

config SIDEWALK_GPIO_MAX
	int
	default 12 if SIDEWALK_SUBGHZ_SUPPORT
	default 0
	help
	  Maximum number of GPIO assigned for use with Sidewalk GPIO API

config SIDEWALK_ACE_OSAL_ZEPHYR
	bool
	default SIDEWALK
	help
	  Zephyr RTOS abstraction layer for Sidewalk

config SIDEWALK_TEMPERATURE
	bool
	default SIDEWALK_SUBGHZ_SUPPORT
	imply SENSOR
	imply TEMP_NRF5
	help
	  Sidewalk temperature module

config SIDEWALK_SW_INTERRUPTS
	bool
	default SIDEWALK
	help
	  Sidewalk software interrupts module

config SIDEWALK_DELAY
	bool
	default SIDEWALK
	help
	  Sidewalk delay module

config SIDEWALK_SPI_BUS
	bool
	default SIDEWALK_SUBGHZ_SUPPORT
	imply SPI
	imply SIDEWALK_GPIO
	imply PM
	imply PM_DEVICE
	help
	  SPI bus interface for sidewalk

config SPI_NRFX_RAM_BUFFER_SIZE
	default 0 if SIDEWALK_SUBGHZ_SUPPORT

# Hidden configuration (experimental)
config SIDEWALK_SWI_PRIORITY
	int
	default 0

config SIDEWALK_SWI_STACK_SIZE
	int
	default 4096

config SIDEWALK_GPIO_IRQ_PRIORITY
	int
	default 1

config SIDEWALK_GPIO_IRQ_STACK_SIZE
	int
	default 2048

config SIDEWALK_THREAD_TIMER
	bool
	default n

if SIDEWALK_THREAD_TIMER
config SIDEWALK_TIMER_PRIORITY
	int
	default 2

config SIDEWALK_TIMER_STACK_SIZE
	int
	default 2048
endif # Hidden configuration (experimental)
```

## boards/shields/nrf54l15dk_arduino_adapter/Kconfig.shield
```kconfig
# Copyright (c) 2024 Nordic Semiconductor
# SPDX-License-Identifier: Apache-2.0

config SHIELD_NRF54L15DK_ARDUINO_ADAPTER
	def_bool $(shields_list_contains,nrf54l15dk_arduino_adapter)
	depends on BOARD_NRF54L15DK_NRF54L15_CPUAPP
	help
	  Arduino header adapter shield for nrf54l15dk.
	  This shield maps nrf54l15dk pins to Arduino header format,
	  allowing standard Arduino shields to work on nrf54l15dk.
```

## boards/shields/nrf_sidewalk_eb/Kconfig.shield
```kconfig
# Copyright (c) 2026 Nordic Semiconductor ASA
# SPDX-License-Identifier: LicenseRef-Nordic-5-Clause

config SHIELD_NRF_SIDEWALK_EB
	def_bool $(shields_list_contains,nrf_sidewalk_eb)
```

## boards/shields/semtech_lr11xxmb1xxs/Kconfig.shield
```kconfig
# Copyright (c) 2024 Semtech Corporation
# SPDX-License-Identifier: Apache-2.0

config SHIELD_SEMTECH_LR1110MB1xxS
	def_bool $(shields_list_contains,semtech_lr1110mb1xxs)
```

## boards/shields/simple_arduino_adapter/Kconfig.shield
```kconfig
# Copyright (c) 2024 Nordic Semiconductor
# SPDX-License-Identifier: Apache-2.0

config SHIELD_SIMPLE_ARDUINO_ADAPTER
	def_bool $(shields_list_contains,simple_arduino_adapter)
	help
	  This shield maps nrf board pins to Arduino header format,
	  allowing standard Arduino shields to work on every nrf board.
```

## pal/Kconfig
```kconfig
#
# Copyright (c) 2022 Nordic Semiconductor ASA
#
# SPDX-License-Identifier: LicenseRef-Nordic-4-Clause
#

config SIDEWALK_PAL_CRYPTO_PSA_ENABLED
	bool "Use PSA API in Sidewalk crypto pal."
	default y
```

## samples/ble_only/sample.yaml
```yaml
sample:
  name: Sidewalk BLE only sample
  description: Sample implementing Amazon Sidewalk End Device
tests:
  sample.sidewalk.ble_only:
    build_only: true
    platform_allow: nrf52840dk_nrf52840
    integration_platforms:
      - nrf52840dk_nrf52840
    tags: Sidewalk

  sample.sidewalk.ble_only.cli:
    build_only: true
    platform_allow: nrf52840dk_nrf52840
    extra_args: CONFIG_SIDEWALK_CLI=y
    integration_platforms:
      - nrf52840dk_nrf52840
    tags: Sidewalk_cli

  
```

## samples/common/Kconfig
```kconfig
#
# Copyright (c) 2022 Nordic Semiconductor ASA
#
# SPDX-License-Identifier: LicenseRef-Nordic-4-Clause
#
mainmenu "Sidewalk nRF Connect Application"

# DFU
menuconfig SIDEWALK_DFU
	bool "DFU service in Sidewalk sample"
	default y

if SIDEWALK_DFU

choice SIDEWALK_DFU_SERVICE
	prompt "DFU image upload transport"
	default SIDEWALK_DFU_SERVICE_BLE

config SIDEWALK_DFU_SERVICE_BLE
	bool "Upload image over BLE"

config SIDEWALK_DFU_SERVICE_USB
	bool "Upload image over USB. Test only!"
endchoice

if SIDEWALK_DFU_SERVICE_BLE
config SIDEWALK_DFU_BLE_FAST
	bool "Speed up DFU over BLE"
	default n

config MCUMGR
	default y

config MCUMGR_CMD_IMG_MGMT
	default y

config MCUMGR_CMD_OS_MGMT
	default y

config MCUMGR_SMP_BT
	default y

config MCUMGR_SMP_BT_AUTHEN
	default n

config MCUMGR_SMP_BT_CONN_PARAM_CONTROL
	default y

config MCUMGR_SMP_REASSEMBLY_BT
	default y if SIDEWALK_DFU_BLE_FAST

config MCUMGR_BUF_SIZE
	default 2475 if SIDEWALK_DFU_BLE_FAST

config OS_MGMT_MCUMGR_PARAMS
	default y if SIDEWALK_DFU_BLE_FAST
endif # SIDEWALK_DFU_SERVICE_BLE

if SIDEWALK_DFU_SERVICE_USB
config USB_DFU_CLASS
	default y

config USB_DEVICE_STACK
	default y

config USB_DFU_ENABLE_UPLOAD
	default y

config USB_DFU_REBOOT
	default y

config USB_DEVICE_PRODUCT
	default "DFU for Sidewalk"

config USB_DC_HAS_HS_SUPPORT
	default y

config USB_REQUEST_BUFFER_SIZE
	default 8192
endif # SIDEWALK_DFU_SERVICE_USB

endif # SIDEWALK_DFU

# Bootloader
config IMG_MANAGER
	default y

config BOOTLOADER_MCUBOOT
	default y

config FLASH
	default y

config FLASH_PAGE_LAYOUT
	default y

config EXTRA_EXCEPTION_INFO
	default y

# Bluetooth
config BT_REMOTE_VERSION
	default y

config BT_BUF_ACL_TX_SIZE
	default 251
	default 502 if SIDEWALK_DFU_BLE_FAST

config BT_BUF_ACL_TX_COUNT
	default 3

config BT_BUF_ACL_RX_SIZE
	default 251
	default 502 if SIDEWALK_DFU_BLE_FAST

config BT_BUF_ACL_RX_COUNT
	default 6

config BT_L2CAP_TX_MTU
	default 247
	default 498 if SIDEWALK_DFU_BLE_FAST

config BT_CTLR_DATA_LENGTH_MAX
	default 247
	default 251 if SIDEWALK_DFU_BLE_FAST

config BT_PERIPHERAL_PREF_MIN_INT
	default 16

config BT_PERIPHERAL_PREF_MAX_INT
	default 60

config BT_PERIPHERAL_PREF_LATENCY
	default 0

config BT_PERIPHERAL_PREF_TIMEOUT
	default 400

# Stack
config SYSTEM_WORKQUEUE_STACK_SIZE
    int
    default 4096 if SIDEWALK_LINK_MASK_LORA || SIDEWALK_LINK_MASK_FSK
	default 4096 if SIDEWALK_DFU_SERVICE_BLE
```
