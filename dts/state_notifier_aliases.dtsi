/*
 * Copyright (c) 2026 Nordic Semiconductor ASA
 *
 * SPDX-License-Identifier: LicenseRef-Nordic-5-Clause
 */

/* Alias names are matched by utils/state_notifier/state_notifier_gpio_backend.c
 * through DT_ALIAS(state_notifier_<state>), so they must not be renamed.
 */

/ {
	aliases {
		state-notifier-connected = &led0;
		state-notifier-time-sync = &led1;
		state-notifier-registered = &led2;
		state-notifier-working = &led3;
	};
};
