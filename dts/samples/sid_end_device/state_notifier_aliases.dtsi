/*
 * Copyright (c) 2026 Nordic Semiconductor ASA
 *
 * SPDX-License-Identifier: LicenseRef-Nordic-5-Clause
 */

/ {
	aliases {
		state-notifier-connected = &led0;
		state-notifier-time-sync = &led1;
		state-notifier-registered = &led2;
		state-notifier-working = &led3;
	};
};
