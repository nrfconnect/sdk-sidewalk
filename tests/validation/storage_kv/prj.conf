## CMakeLists.txt
```
#
# Copyright (c) 2022 Nordic Semiconductor ASA
#
# SPDX-License-Identifier: LicenseRef-Nordic-5-Clause
#

cmake_minimum_required(VERSION 3.20.0)

find_package(Zephyr REQUIRED HINTS $ENV{ZEPHYR_BASE})
project(sid_validation_storage_kv)

target_sources(app PRIVATE src/main.c)
target_include_directories(app PRIVATE src)
target_link_options(app PRIVATE "LINKER:--start-group")
target_link_libraries(app PRIVATE sidewalk_pal)
target_link_options(app PRIVATE "LINKER:--end-group")
```

## Kconfig
```
#
# Copyright (c) 2024 Nordic Semiconductor ASA
#
# SPDX-License-Identifier: LicenseRef-Nordic-5-Clause
#

config SIDEWALK_MFG_STORAGE
        default n

source "Kconfig.zephyr"
```

## prj.conf
```kconfig
#
# Copyright (c) 2022 Nordic Semiconductor ASA
#
# SPDX-License-Identifier: LicenseRef-Nordic-5-Clause
#
CONFIG_UNITY=y
CONFIG_ZTEST=y
CONFIG_SIDEWALK=y
CONFIG_SIDEWALK_DFU=n
CONFIG_SIDEWALK_SUBGHZ_SUPPORT=n
CONFIG_SIDEWALK_CRYPTO_PSA_KEY_STORAGE=n
CONFIG_SIDEWALK_LOG_LEVEL_OFF=y
CONFIG_NVS_LOG_LEVEL_OFF=y

# Debug
CONFIG_RESET_ON_FATAL_ERROR=n

# FPU
CONFIG_FPU=y
CONFIG_PARTITION_MANAGER_ENABLED=y
```

## src/main.c
```c
/*
 * Copyright 2021 Amazon.com, Inc. or its affiliates.  All rights reserved.
 *
 * AMAZON PROPRIETARY/CONFIDENTIAL
 *
 * You may not use this file except in compliance with the terms and conditions
 * set forth in the accompanying LICENSE.TXT file.
 *
 * THESE MATERIALS ARE PROVIDED ON AN "AS IS" BASIS. AMAZON SPECIFICALLY
 * DISCLAIMS, WITH RESPECT TO THESE MATERIALS, ALL WARRANTIES, EXPRESS,
 * IMPLIED, OR STATUTORY, INCLUDING THE IMPLIED WARRANTIES OF MERCHANTABILITY,
 * FITNESS FOR A PARTICULAR PURPOSE, AND NON-INFRINGEMENT.
 */
#include <zephyr/ztest.h>

#include <sid_pal_storage_kv_ifc.h>
#include <storage_kv_keys.h>

#include <string.h>

#define SID_PAL_STORAGE_KV_INTERNAL_PROTOCOL_GROUP_ID 0

#define DEV_ID_SZ 5
#define DEV_VER_SZ 2
#define PROT_VER_SZ 2

void before_test(void *fixture)
{
	zassert_equal(SID_ERROR_NONE, sid_pal_storage_kv_init());
}

void after_test(void *fixture)
{
	zassert_equal(SID_ERROR_NONE, sid_pal_storage_kv_group_delete(
					      SID_PAL_STORAGE_KV_INTERNAL_PROTOCOL_GROUP_ID));
}

/* Helper function to populate records to test deletion */
static void set_record()
{
	sid_error_t ret;
    uint8_t id[DEV_ID_SZ] = {0x99, 0x88};

	ret = sid_pal_storage_kv_record_set(SID_PAL_STORAGE_KV_INTERNAL_PROTOCOL_GROUP_ID,
					    STORAGE_KV_DBG_DEV_ID, id, DEV_ID_SZ);
	zassert_equal(SID_ERROR_NONE, ret);
}

static uint32_t roundup_to_word(uint32_t v)
{
    return (v + 3u)/4u * 4u;
}

/* Test basic record set and get */
ZTEST(storage, test_record_set_get)
{
	sid_error_t ret;
    uint8_t dev_id[DEV_ID_SZ] = {0xfe, 0xed, 0xfa, 0xce, 0xa1};
	uint8_t id[DEV_ID_SZ];
    uint8_t dev_ver[DEV_VER_SZ] = {0x5, 0x6};
	uint8_t ver[DEV_VER_SZ];
	uint32_t len;

	ret = sid_pal_storage_kv_record_set(SID_PAL_STORAGE_KV_INTERNAL_PROTOCOL_GROUP_ID,
					    STORAGE_KV_DBG_DEV_ID, dev_id, DEV_ID_SZ);
	zassert_equal(SID_ERROR_NONE, ret);

	ret = sid_pal_storage_kv_record_set(SID_PAL_STORAGE_KV_INTERNAL_PROTOCOL_GROUP_ID,
					    STORAGE_KV_DEV_VERSION, dev_ver, DEV_VER_SZ);
	zassert_equal(SID_ERROR_NONE, ret);

	ret = sid_pal_storage_kv_record_get_len(SID_PAL_STORAGE_KV_INTERNAL_PROTOCOL_GROUP_ID,
						STORAGE_KV_DBG_DEV_ID, &len);
	zassert_equal(SID_ERROR_NONE, ret);
    zassert_true(len>=DEV_ID_SZ);
	zassert_true(len <= roundup_to_word(DEV_ID_SZ));

	ret = sid_pal_storage_kv_record_get(SID_PAL_STORAGE_KV_INTERNAL_PROTOCOL_GROUP_ID,
					    STORAGE_KV_DBG_DEV_ID, id, len);
	zassert_equal(SID_ERROR_NONE, ret);
	zassert_equal(0, memcmp(dev_id, id, DEV_ID_SZ));

	ret = sid_pal_storage_kv_record_get_len(SID_PAL_STORAGE_KV_INTERNAL_PROTOCOL_GROUP_ID,
						STORAGE_KV_DEV_VERSION, &len);
	zassert_equal(SID_ERROR_NONE, ret);
    zassert_true(len>=DEV_VER_SZ);
	zassert_true(len <= roundup_to_word(DEV_VER_SZ));

	ret = sid_pal_storage_kv_record_get(SID_PAL_STORAGE_KV_INTERNAL_PROTOCOL_GROUP_ID,
					    STORAGE_KV_DEV_VERSION, ver, DEV_VER_SZ);
	zassert_equal(SID_ERROR_NONE, ret);
	zassert_equal(0, memcmp(dev_ver, ver, DEV_VER_SZ));
}

/* Test setting record twice updates the record */
ZTEST(storage, test_record_set_twice)
{
	sid_error_t ret;
    uint8_t dev_id[DEV_ID_SZ] = {0xfe, 0xed, 0xfa, 0xce, 0xa1};
    uint8_t dev_id2[DEV_ID_SZ] = {0xca, 0xfe, 0xf0, 0x0d, 0x5e};
	uint8_t id[DEV_ID_SZ];
	uint32_t len;

	ret = sid_pal_storage_kv_record_set(SID_PAL_STORAGE_KV_INTERNAL_PROTOCOL_GROUP_ID,
					    STORAGE_KV_DBG_DEV_ID, dev_id, DEV_ID_SZ);
	zassert_equal(SID_ERROR_NONE, ret);

	ret = sid_pal_storage_kv_record_set(SID_PAL_STORAGE_KV_INTERNAL_PROTOCOL_GROUP_ID,
					    STORAGE_KV_DBG_DEV_ID, dev_id2, DEV_ID_SZ);
	zassert_equal(SID_ERROR_NONE, ret);

	ret = sid_pal_storage_kv_record_get_len(SID_PAL_STORAGE_KV_INTERNAL_PROTOCOL_GROUP_ID,
						STORAGE_KV_DBG_DEV_ID, &len);
	zassert_equal(SID_ERROR_NONE, ret);
    zassert_true(len>=DEV_ID_SZ);
	zassert_true(len <= roundup_to_word(DEV_ID_SZ));

	ret = sid_pal_storage_kv_record_get(SID_PAL_STORAGE_KV_INTERNAL_PROTOCOL_GROUP_ID,
					    STORAGE_KV_DBG_DEV_ID, id, len);
	zassert_equal(SID_ERROR_NONE, ret);
	zassert_equal(0, memcmp(dev_id2, id, DEV_ID_SZ));
}


/* Test re-setting record after a delete */
ZTEST(storage, test_record_set_delete_set)
{
	sid_error_t ret;
    uint8_t dev_id[DEV_ID_SZ] = {0xfe, 0xed, 0xfa, 0xce, 0xa1};
    uint8_t dev_id2[DEV_ID_SZ] = {0xca, 0xfe, 0xf0, 0x0d, 0x5e};
	uint8_t id[DEV_ID_SZ];
	uint32_t len;

	ret = sid_pal_storage_kv_record_set(SID_PAL_STORAGE_KV_INTERNAL_PROTOCOL_GROUP_ID,
					    STORAGE_KV_DBG_DEV_ID, dev_id, DEV_ID_SZ);
	zassert_equal(SID_ERROR_NONE, ret);

	ret = sid_pal_storage_kv_record_delete(SID_PAL_STORAGE_KV_INTERNAL_PROTOCOL_GROUP_ID,
					       STORAGE_KV_DBG_DEV_ID);
	zassert_equal(SID_ERROR_NONE, ret);

	ret = sid_pal_storage_kv_record_set(SID_PAL_STORAGE_KV_INTERNAL_PROTOCOL_GROUP_ID,
					    STORAGE_KV_DBG_DEV_ID, dev_id2, DEV_ID_SZ);
	zassert_equal(SID_ERROR_NONE, ret);

	ret = sid_pal_storage_kv_record_get_len(SID_PAL_STORAGE_KV_INTERNAL_PROTOCOL_GROUP_ID,
						STORAGE_KV_DBG_DEV_ID, &len);
	zassert_equal(SID_ERROR_NONE, ret);
    zassert_true(len>=DEV_ID_SZ);
	zassert_true(len <= roundup_to_word(DEV_ID_SZ));

	ret = sid_pal_storage_kv_record_get(SID_PAL_STORAGE_KV_INTERNAL_PROTOCOL_GROUP_ID,
					    STORAGE_KV_DBG_DEV_ID, id, len);
	zassert_equal(SID_ERROR_NONE, ret);
	zassert_equal(0, memcmp(dev_id2, id, DEV_ID_SZ));
}

/* Test reading non-existent record */
ZTEST(storage, test_record_get_error)
{
	sid_error_t ret;
	uint8_t ver[DEV_VER_SZ];

	ret = sid_pal_storage_kv_record_get(SID_PAL_STORAGE_KV_INTERNAL_PROTOCOL_GROUP_ID,
					    STORAGE_KV_PROTOCOL_VERSION, ver, PROT_VER_SZ);
	zassert_equal(SID_ERROR_NOT_FOUND, ret);
}

/* Test record is properly deleted */
ZTEST(storage, test_record_delete)
{
	sid_error_t ret;
	uint8_t id[DEV_ID_SZ];

	set_record();

	ret = sid_pal_storage_kv_record_delete(SID_PAL_STORAGE_KV_INTERNAL_PROTOCOL_GROUP_ID,
					       STORAGE_KV_DBG_DEV_ID);
	zassert_equal(SID_ERROR_NONE, ret);

	ret = sid_pal_storage_kv_record_get(SID_PAL_STORAGE_KV_INTERNAL_PROTOCOL_GROUP_ID,
					    STORAGE_KV_DBG_DEV_ID, id, DEV_ID_SZ);
	zassert_not_equal(SID_ERROR_NONE, ret);
}

/* Test deleting non-existent record */

ZTEST(storage, test_record_delete_error)
{
	ztest_test_skip();
	// TEST_IGNORE_MESSAGE("There is no error on deleting non-existing record in NVS");

	sid_error_t ret;

	ret = sid_pal_storage_kv_record_delete(SID_PAL_STORAGE_KV_INTERNAL_PROTOCOL_GROUP_ID,
					       STORAGE_KV_PROTOCOL_VERSION);
	zassert_not_equal(SID_ERROR_NONE, ret);
}

/* Test deleting a group removes records */
ZTEST(storage, test_record_group_delete)
{
	sid_error_t ret;
	uint8_t id[DEV_ID_SZ];

	set_record();

	ret = sid_pal_storage_kv_group_delete(SID_PAL_STORAGE_KV_INTERNAL_PROTOCOL_GROUP_ID);
	zassert_equal(SID_ERROR_NONE, ret);

	ret = sid_pal_storage_kv_record_get(SID_PAL_STORAGE_KV_INTERNAL_PROTOCOL_GROUP_ID,
					    STORAGE_KV_DBG_DEV_ID, id, DEV_ID_SZ);
	zassert_not_equal(SID_ERROR_NONE, ret);
}

/* Test deleting group twice */
ZTEST(storage, test_record_group_delete_error)
{
	sid_error_t ret;

	set_record();

	ret = sid_pal_storage_kv_group_delete(SID_PAL_STORAGE_KV_INTERNAL_PROTOCOL_GROUP_ID);
	zassert_equal(SID_ERROR_NONE, ret);

	ret = sid_pal_storage_kv_group_delete(SID_PAL_STORAGE_KV_INTERNAL_PROTOCOL_GROUP_ID);
	zassert_equal(SID_ERROR_NONE, ret);
}

ZTEST_SUITE(storage, NULL, NULL, before_test, after_test, NULL);
```

## src/storage_kv_keys.h
```c
/*
 * Copyright 2018-2025 Amazon.com, Inc. or its affiliates. All rights reserved.
 *
 * AMAZON PROPRIETARY/CONFIDENTIAL
 *
 * You may not use this file except in compliance with the terms and
 * conditions set forth in the accompanying LICENSE.txt file.
 *
 * THESE MATERIALS ARE PROVIDED ON AN "AS IS" BASIS. AMAZON SPECIFICALLY
 * DISCLAIMS, WITH RESPECT TO THESE MATERIALS, ALL WARRANTIES, EXPRESS,
 * IMPLIED, OR STATUTORY, INCLUDING THE IMPLIED WARRANTIES OF MERCHANTABILITY,
 * FITNESS FOR A PARTICULAR PURPOSE, AND NON-INFRINGEMENT.
 */

#ifndef STORAGE_KV_KEYS_H
#define STORAGE_KV_KEYS_H

#ifdef __cplusplus
extern "C" {
#endif

// Note per:
// http://infocenter.nordicsemi.com/index.jsp?topic=%2Fcom.nordic.infocenter.sdk5.v14.2.0%2Flib_fds_functionality.html&cp=4_0_0_3_50_1_4&anchor=lib_fds_functionality_keys
// Record keys need to be in the range 0x0001-0xBFFF

// FDS key IDs used for storing RingNet configuration records in an FDS file
typedef enum {
    STORAGE_KV_VERSION = 1,
    STORAGE_KV_PEERING_CHANNEL,                 // 2
    STORAGE_KV_PAN_ID,                          // 3
    STORAGE_KV_P2P_BROADCAST_KEY,               // 4
    STORAGE_KV_P2P_UNICAST_KEY,                 // 5
    STORAGE_KV_DBG_DEV_ID,                      // 6
    STORAGE_KV_UNCONFIRMED_MULTICAST_RETRIES,   // 7
    STORAGE_KV_GROUP_NUM,                       // 7
    STORAGE_KV_SEC_BLE_CONTEXT_KEY,             // 9  // GCMKEY(16B)+PeerNonce(8B)+Counter(6B)
    STORAGE_KV_SEC_CLOUD_CONTEXT_KEY,           // 10  // GCMKEY(16B)+PeerNonce(8B)+Counter(6B)
    STORAGE_KV_PAIRING_STATE_KEY,               // 11
    STORAGE_KV_KA_INTERVAL,                     // 12
    STORAGE_KV_REJOIN_PARAMS,                   // 13
    STORAGE_KV_DFU_PARAMS,                      // 14
    STORAGE_KV_CAD_PARAMS,                      // 15
    STORAGE_KV_RF_SECURITY_SETTINGS,            // 16
    STORAGE_KV_SLEEPY_DEVICE_PARAMS,            // 17
    STORAGE_KV_PROTOCOL_SWITCH,                 // 18
    STORAGE_KV_MAX_BCN_MISS,                    // 19
    STORAGE_KV_BCN_INTERVAL_FACTOR,             // 20
    STORAGE_KV_LDR_CHANNEL,                     // 21
    STORAGE_KV_INTERNAL_MAC_SWITCH,             // 22
    STORAGE_KV_DEV_VERSION,                     // 23
    STORAGE_KV_NG_DISCOVERY_PARAMS,             // 24
    STORAGE_KV_HOMEPAN_SCAN_INTVL,              // 25
    STORAGE_KV_PROTOCOL_VERSION,                // 26
    STORAGE_KV_SIDEWALK_NW_FLAG,                // 27
    STORAGE_KV_WAN_MASTER_KEY,                  // 28
    STORAGE_KV_WAN_KEY_PARAMS,                  // 29
    STORAGE_KV_APP_MASTER_KEY,                  // 30
    STORAGE_KV_APP_KEY_PARAMS,                  // 31
    STORAGE_KV_TSYNC_COUNTER_SEED,              // 32
    STORAGE_KV_TSYNC_COUNTER,                   // 33
    STORAGE_KV_TX_UUID_PARAMS,                  // 34
    STORAGE_KV_RF_POWER_LORA,                   // 35
    STORAGE_KV_RF_POWER_FSK,                    // 36
    STORAGE_KV_HDR_PRDCTY_INFO,                 // 37
    STORAGE_KV_HDR_OFFSET_INFO,                 // 38
    STORAGE_KV_CONFIGURATION_COMPLETE,          // 39
    STORAGE_KV_LAST_OPERATING_GW_MODE,          // 40
    STORAGE_KV_DISTRESS_GWD_PARAMS,             // 41
    STORAGE_KV_TMP_PRTCL_EXP,                   // 42   record for temporary protocol configuration needs
    STORAGE_KV_SIDEWALK_ID,                     // 43
    STORAGE_KV_HDR_WAKEUP_INFO,                 // 44
    STORAGE_KV_RF_POWER,                        // 45
    STORAGE_KV_DEVICE_CLASS_FSK,                // 46
    STORAGE_KV_DEVICE_CLASS_LDR,                // 47
    STORAGE_KV_D2D_MASTER_KEY,                  // 48
    STORAGE_KV_D2D_KEY_PARAMS,                  // 49
    STORAGE_KV_DIAG_PHY_MODEM,                  // 50
    STORAGE_KV_DIAG_PHY_FP,                     // 51
    STORAGE_KV_DIAG_PHY_MOD_FSK,                // 52
    STORAGE_KV_DIAG_PHY_MOD_LORA,               // 53
    STORAGE_KV_DIAG_PHY_PKT_FSK,                // 54
    STORAGE_KV_DIAG_PHY_PKT_LORA,               // 55
    STORAGE_KV_DIAG_MODULATION,                 // 56
    STORAGE_KV_LORA_LOW_LATENCY_PARAMS,         // 57
    STORAGE_KV_EP_CAP_PARAMS,                   // 58
    STORAGE_KV_EP_CFG_PARAMS,                   // 59
    STORAGE_KV_EP_METRICS_EN_CONFIG,            // 60
    STORAGE_KV_GW_DISTRESS_DISC_STATS,          // 61
    STORAGE_KV_LAST_ENTRY,
    STORAGE_KV_EXTRY_MAX_VALUE = 0x6FFE
} storage_kv_key_t;

// These are separate, because these might be removed
typedef enum {
    STORAGE_KV_BULK_DATA_TRANSFER_NUMBER_OF_ONGOING_FILE_TRANSFERS = 1,

    STORAGE_KV_BULK_DATA_TRANSFER_FILE_ID = 20,
    STORAGE_KV_BULK_DATA_TRANSFER_BLOCK_SIZE,
    STORAGE_KV_BULK_DATA_TRANSFER_TOTAL_BLOCKS,
    STORAGE_KV_BULK_DATA_TRANSFER_LAST_BLOCK_SIZE,
    STORAGE_KV_BULK_DATA_TRANSFER_LAST_BLOCK_ID,
    STORAGE_KV_BULK_DATA_TRANSFER_LAST_BLOCK_SEQ_NUM,
    STORAGE_KV_BULK_DATA_TRANSFER_LAST_BLOCK_CHUNK_SIZE,
    STORAGE_KV_BULK_DATA_TRANSFER_FILE_DESCRIPTOR,
    STORAGE_KV_BULK_DATA_TRANSFER_LAST_ENTRY = 40,
    STORAGE_KV_BULK_DATA_TRANSFER_ENTRY_MAX = 0x6FFE
} storage_kv_bulk_data_transfer_key_t;

typedef enum {
    STORAGE_KV_BULK_DATA_TRANSFER_NUMBER_OF_ONGOING_FILE_TRANSFERS_SIZE = 4,
    STORAGE_KV_BULK_DATA_TRANSFER_FILE_ID_SIZE = 4,
    STORAGE_KV_BULK_DATA_TRANSFER_BLOCK_SIZE_SIZE = 2,
    STORAGE_KV_BULK_DATA_TRANSFER_TOTAL_BLOCKS_SIZE = 2,
    STORAGE_KV_BULK_DATA_TRANSFER_LAST_BLOCK_SIZE_SIZE = 2,
    STORAGE_KV_BULK_DATA_TRANSFER_LAST_BLOCK_ID_SIZE = 2,
    STORAGE_KV_BULK_DATA_TRANSFER_LAST_BLOCK_SEQ_NUM_SIZE = 4,
    STORAGE_KV_BULK_DATA_TRANSFER_LAST_BLOCK_CHUNK_SIZE_SIZE = 2,
} storage_kv_bulk_data_transfer_value_size_t;

typedef enum {
    STORAGE_KV_EP_METRICS_DATA = 1,   // 1
} storage_kv_metrics_ep_data_key_t;

typedef enum {
    STORAGE_KV_DIAG_SETUP_FAILURE = 1,
    STORAGE_KV_DIAG_SETUP_PRODUCT_SPECIFIC_FAILURE = 2,
    STORAGE_KV_DIAG_SETUP_SESSION = 3,
    STORAGE_KV_DIAG_SETUP_START_REASON = 4,
    STORAGE_KV_DIAG_SETUP_INDEX = 5,
    STORAGE_KV_DIAG_SETUP_FAILURE_COUNT = 6,
} storage_kv_diag_key_t;

#ifdef __cplusplus
}
#endif

#endif
```
