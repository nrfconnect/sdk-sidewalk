## tests/integration/spi/testcase.yaml
```yaml
tests:
  sidewalk.test.integration.spi:
    sysbuild: true
    tags: Sidewalk
    platform_allow:
      - nrf54l15dk/nrf54l15/cpuapp
      - nrf54l15dk/nrf54l10/cpuapp
    integration_platforms:
      - nrf54l15dk/nrf54l15/cpuapp
    extra_args:
      - SHIELD="simple_arduino_adapter;semtech_sx1262mb2cas"

  sidewalk.test.integration.spi.lr1110:
    sysbuild: true
    tags: Sidewalk
    platform_allow:
      - nrf54l15dk/nrf54l15/cpuapp
      - nrf54l15dk/nrf54l10/cpuapp
    integration_platforms:
      - nrf54l15dk/nrf54l15/cpuapp
    extra_args:
      - SHIELD="simple_arduino_adapter;semtech_lr1110mb1xxs"
```

## tests/integration/timer/Kconfig
```kconfig
#
# Copyright (c) 2022 Nordic Semiconductor ASA
#
# SPDX-License-Identifier: LicenseRef-Nordic-5-Clause
#
config SIDEWALK_BUILD
	default y

config SIDEWALK_USE_PREBUILT_LIBRARIES
	default y


config SIDEWALK_TIMER
	default y

config SIDEWALK_UPTIME
	default y

config SIDEWALK_ASSERT
	default y

config SIDEWALK_LOG
	default y
	imply LOG

config SIDEWALK_LOG_LEVEL
	default 0

config SIDEWALK_LOG_MSG_LENGTH_MAX
	default 80


source "Kconfig.zephyr"
source "${ZEPHYR_BASE}/../sidewalk/Kconfig.dependencies"
```

## tests/integration/uptime/testcase.yaml
```yaml
tests:
  sidewalk.test.integration.uptime:
    sysbuild: true
    tags: Sidewalk
    platform_allow:
      - native_sim
      - nrf54l15dk/nrf54l15/cpuapp
      - nrf54l15dk/nrf54l10/cpuapp
      - nrf52840dk/nrf52840
      - nrf54lv10dk/nrf54lv10a/cpuapp
      - nrf54lm20dk/nrf54lm20a/cpuapp
      - nrf54lm20dk/nrf54lm20b/cpuapp
    integration_platforms:
      - nrf54l15dk/nrf54l15/cpuapp
```

## tests/manual/power/child_image/mcuboot/Kconfig.root
```kconfig
#
# Copyright (c) 2023 Nordic Semiconductor ASA
#
# SPDX-License-Identifier: LicenseRef-Nordic-5-Clause
#

# The purpose of this file is to create a wrapper Kconfig file that will be set as
# mcuboot_KCONFIG_ROOT and processed before any other Kconfig for mcuboot child image.

source "${ZEPHYR_BASE}/../sidewalk/samples/common/Kconfig.mcuboot.external_flash.defaults"
source "${ZEPHYR_BASE}/../bootloader/mcuboot/boot/zephyr/Kconfig"
```

## tests/manual/simple_bootloader/sysbuild/mcuboot/boards/nrf54l15dk_nrf54l10_cpuapp.conf
```kconfig
#
# Copyright (c) 2021 Nordic Semiconductor ASA
#
# SPDX-License-Identifier: LicenseRef-Nordic-5-Clause
#

# TODO: NCSDK-28931: Cannot use fprotect twice, so disable it in MCUboot to
# test protecting Matter factory data. It can be enabled while there is a support
# for protection more than one region.
CONFIG_FPROTECT=n
# TODO: Workaround, disable memory guard to avoid false faults in application after boot
CONFIG_HW_STACK_PROTECTION=n

CONFIG_BOOT_WATCHDOG_FEED=n

# Disable all debug features
CONFIG_USE_SEGGER_RTT=n
CONFIG_SHELL=n
CONFIG_OPENTHREAD_SHELL=n
CONFIG_CONSOLE=n
CONFIG_UART_CONSOLE=n
CONFIG_SERIAL=n
CONFIG_LOG=n
CONFIG_LOG_MODE_MINIMAL=n
CONFIG_ASSERT_VERBOSE=n
CONFIG_ASSERT_NO_FILE_INFO=y
CONFIG_PRINTK=n
CONFIG_PRINTK_SYNC=n
CONFIG_THREAD_NAME=n
CONFIG_BOOT_BANNER=n

CONFIG_PM_OVERRIDE_EXTERNAL_DRIVER_CHECK=y

# Ensure that the qspi driver is disabled by default
CONFIG_GPIO=n
CONFIG_SPI=n
CONFIG_SPI_NOR=n
CONFIG_NORDIC_QSPI_NOR=n
CONFIG_MULTITHREADING=n

CONFIG_PM_OVERRIDE_EXTERNAL_DRIVER_CHECK=y


# Workaroud: fprotect and watchdog feed
# are not supported in NCS v2.6.0
CONFIG_FPROTECT=n
CONFIG_BOOT_WATCHDOG_FEED=n

# Currently, without tickless kernel, the SYSCOUNTER value after the software
# reset is not set properly and due to that the first system interrupt is not called
# in the proper time - the SYSCOUNTER value is set to the value from before
# reset + 1. Hence, the reboot time increases more and more.
# To avoid it enable tickles kernel for mcuboot.
CONFIG_TICKLESS_KERNEL=y
```

## tests/manual/simple_bootloader/sysbuild/mcuboot/boards/nrf54l15dk_nrf54l15_cpuapp.conf
```kconfig
#
# Copyright (c) 2021 Nordic Semiconductor ASA
#
# SPDX-License-Identifier: LicenseRef-Nordic-5-Clause
#

CONFIG_BOOT_MAX_IMG_SECTORS=256

# Ensure that the qspi driver is disabled by default
CONFIG_NORDIC_QSPI_NOR=n
CONFIG_SPI_NOR=n

# TODO: below are not yet supported and need fixing
CONFIG_FPROTECT=n
CONFIG_BOOT_WATCHDOG_FEED=n
```

## tests/nrf_integration/testcase.yaml
```yaml
tests:
  unity.sidewalk.nrf_integration:
    tags: Sidewalk
    platform_allow: nrf52840dk_nrf52840
    integration_platforms:
      - nrf52840dk_nrf52840
```

## tests/sidewalk_functional_tests/testcase.yaml
```yaml
tests:
  unity.sidewalk.integration_test:
    tags: Sidewalk
    platform_allow: nrf52840dk_nrf52840
    integration_platforms:
      - nrf52840dk_nrf52840
```

## tests/sidewalk_tests/testcase.yaml
```yaml
tests:
  unity.sidewalk.unit_tests:
    tags: Sidewalk
    integration_platforms:
      - native_posix
```

## tests/unit_tests/flash_led/testcase.yaml
```yaml
tests:
   sidewalk.unit_tests.flash_led:
    tags: Sidewalk
    platform_allow: native_posix nrf52840dk_nrf52840
       integration_platforms:
      - native_posix
      - nrf52840dk_nrf52840
```

## tests/unit_tests/mfg_parsers/testcase.yaml
```yaml
tests:
  sidewalk.unit_tests.mfg_parser:
    sysbuild: true
    platform_allow:
      - native_posix
      - nrf52840dk/nrf52840
      - nrf5340dk/nrf5340/cpuapp
      - nrf54l15dk/nrf54l15/cpuapp
      - nrf54l15dk/nrf54l10/cpuapp
    tags: Sidewalk
    integration_platforms:
      - native_posix
      - nrf52840dk/nrf52840
      - nrf5340dk/nrf5340/cpuapp
      - nrf54l15dk/nrf54l15/cpuapp
      - nrf54l15dk/nrf54l10/cpuapp

  sidewalk.unit_tests.mfg_parser_psa_storage:
    sysbuild: true
    platform_allow: native_posix
    tags: Sidewalk
    integration_platforms:
      - native_posix
    extra_configs:
      - CONFIG_SIDEWALK_CRYPTO_PSA_KEY_STORAGE=y
```

## tests/unit_tests/pal_assert/testcase.yaml
```yaml
tests:
  sidewalk.test.unit.assert:
    sysbuild: false
    tags: Sidewalk
    type: unit
```

## tests/unit_tests/pal_ble_adapter/testcase.yaml
```yaml
tests:
  sidewalk.test.unit.ble_adapter:
    sysbuild: true
    platform_allow: native_posix
    tags: Sidewalk
    integration_platforms:
      - native_posix
```

## tests/unit_tests/pal_critical_region/testcase.yaml
```yaml
tests:
  sidewalk.unit_tests.critical_region:
    platform_allow: nrf52840dk_nrf52840 native_posix
    tags: Sidewalk
    integration_platforms:
      - native_posix
      - nrf52840dk_nrf52840
```

## tests/unit_tests/pal_crypto/testcase.yaml
```yaml
tests:
  sidewalk.test.unit.crypto:
    sysbuild: true
    tags: Sidewalk
    platform_allow: native_sim
    integration_platforms:
      - native_sim
```

## tests/unit_tests/pal_log/testcase.yaml
```yaml
tests:
  sidewalk.test.unit.log:
    sysbuild: false
    tags: Sidewalk
    type: unit
```

## tests/unit_tests/pal_mfg_storage/testcase.yaml
```yaml
tests:
  sidewalk.test.unit.mfg_storage:
    skip: true
    sysbuild: true
    platform_allow: native_sim
    tags: Sidewalk
    integration_platforms:
      - native_sim
```

## tests/unit_tests/pal_storage_kv/testcase.yaml
```yaml
tests:
  sidewalk.test.unit.storage_kv.NVS:
    sysbuild: true
    platform_allow: native_sim
    tags: Sidewalk
    integration_platforms:
      - native_sim

  sidewalk.test.unit.storage_kv.ZMS:
    sysbuild: true
    platform_allow: native_sim
    tags: Sidewalk
    integration_platforms:
      - native_sim
    extra_configs:
      - CONFIG_NVS=n
      - CONFIG_SETTINGS_NVS=n
      - CONFIG_ZMS=y
      - CONFIG_SETTINGS_ZMS=y
```

## tests/unit_tests/pal_sw_interrupts/testcase.yaml
```yaml
tests:
  sidewalk.test.unit.interrupts:
    sysbuild: false
    tags: Sidewalk
    type: unit
```

## tests/unit_tests/pal_temperature/testcase.yaml
```yaml
tests:
  sidewalk.test.unit.temperature:
    sysbuild: true
    platform_allow: native_sim
    tags: Sidewalk
    integration_platforms:
      - native_sim
```

## tests/unit_tests/pal_timer/testcase.yaml
```yaml
tests:
  sidewalk.test.unit.timer:
    sysbuild: true
    platform_allow: native_posix
    tags: Sidewalk
    integration_platforms:
      - native_posix
```

## tests/unit_tests/pal_uptime/testcase.yaml
```yaml
tests:
  sidewalk.test.unit.uptime:
    sysbuild: false
    tags: Sidewalk
    type: unit
```

## tests/unit_tests/scratch_buffer/Kconfig
```kconfig
#
# Copyright (c) 2024 Nordic Semiconductor ASA
#
# SPDX-License-Identifier: LicenseRef-Nordic-5-Clause
#

config SBDT_MAX_PARALLEL_TRANSFERS
	int 
	default 3

source "Kconfig.zephyr"
```

## tests/unit_tests/scratch_buffer/testcase.yaml
```yaml
tests:
  sidewalk.test.unit.scratch_buffer:
    sysbuild: false
    tags: Sidewalk
    type: unit
```

## tests/unit_tests/sid_ace_alloc/testcase.yaml
```yaml
tests:
  sidewalk.test.unit.ace.alloc:
    sysbuild: false
    tags: Sidewalk
    type: unit
```
