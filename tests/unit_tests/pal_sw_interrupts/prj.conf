## CMakeLists.txt
```
#
# Copyright (c) 2022 Nordic Semiconductor ASA
#
# SPDX-License-Identifier: LicenseRef-Nordic-5-Clause
#

cmake_minimum_required(VERSION 3.20.0)

set(CMAKE_EXPORT_COMPILE_COMMANDS ON)
set(BOARD unit_testing)
project(sidewalk_test_critical_region)
find_package(Zephyr COMPONENTS unittest REQUIRED HINTS $ENV{ZEPHYR_BASE})

get_filename_component(SIDEWALK_BASE ${CMAKE_CURRENT_LIST_DIR}/../../.. ABSOLUTE)
include(${SIDEWALK_BASE}/tests/cmake/sidewalk_test_ifc.cmake)

add_definitions(--include ztest.h)

target_include_directories(testbinary PRIVATE
	src
	${SIDEWALK_BASE}/subsys/sal/sid_pal/include
)

sidewalk_link_test_ifc(testbinary ${SIDEWALK_BASE} ${CMAKE_CURRENT_BINARY_DIR} sid_pal_swi_ifc)

target_compile_definitions(testbinary PRIVATE CONFIG_SIDEWALK_SWI_PRIORITY=1 CONFIG_SIDEWALK_SWI_STACK_SIZE=2048)

target_sources(testbinary PRIVATE ${SIDEWALK_BASE}/subsys/sal/sid_pal/src/sid_sw_interrupts.c)

target_sources(testbinary PRIVATE
    src/main.c
    src/mock_zephyr.c
)
```

## Kconfig
```
#
# Copyright (c) 2022 Nordic Semiconductor ASA
#
# SPDX-License-Identifier: LicenseRef-Nordic-5-Clause
#

config SIDEWALK_BUILD
	default y

config SIDEWALK_PAL_ZEPHYR_LIBS_DISABLED
	default y

source "Kconfig.zephyr"
```

## prj.conf
```kconfig
#
# Copyright (c) 2022 Nordic Semiconductor ASA
#
# SPDX-License-Identifier: LicenseRef-Nordic-5-Clause
#
```

## src/main.c
```c
/*
 * Copyright (c) 2022 Nordic Semiconductor ASA
 *
 * SPDX-License-Identifier: LicenseRef-Nordic-5-Clause
 */
#include <zephyr/ztest.h>
#include <sid_pal_swi_ifc.h>

void mock_callback(void)
{
	/* Intentionally left blanc. */
}

static void swi_init_start(void *fixture)
{
	ARG_UNUSED(fixture);
	zassert_equal(sid_pal_swi_init(), SID_ERROR_NONE);
	zassert_equal(sid_pal_swi_start(mock_callback), SID_ERROR_NONE);
}

static void swi_stop_deinit(void *fixture)
{
	ARG_UNUSED(fixture);
	zassert_equal(sid_pal_swi_stop(), SID_ERROR_NONE);
	zassert_equal(sid_pal_swi_deinit(), SID_ERROR_NONE);
}

ZTEST(swi_tests, test_swi_reinit)
{
	zassert_equal(sid_pal_swi_deinit(), SID_ERROR_NONE);
	zassert_equal(sid_pal_swi_deinit(), SID_ERROR_NONE);
	zassert_equal(sid_pal_swi_init(), SID_ERROR_NONE);
	zassert_equal(sid_pal_swi_init(), SID_ERROR_NONE);
}

ZTEST(swi_tests, test_swi_start_with_null)
{
	zassert_equal(sid_pal_swi_start(NULL), SID_ERROR_NULL_POINTER);
}

ZTEST(swi_tests, test_swi_trigger_positive)
{
	zassert_equal(sid_pal_swi_trigger(), SID_ERROR_NONE);
}

ZTEST(swi_tests, test_swi_trigger_negative)
{
	/* stop - fail, restart - ok */
	zassert_equal(sid_pal_swi_stop(), SID_ERROR_NONE);
	zassert_equal(sid_pal_swi_trigger(), SID_ERROR_INVALID_STATE);

	zassert_equal(sid_pal_swi_start(mock_callback), SID_ERROR_NONE);
	zassert_equal(sid_pal_swi_trigger(), SID_ERROR_NONE);

	/* deinit - fail, reinit -ok */
	swi_stop_deinit(NULL);
	zassert_equal(sid_pal_swi_trigger(), SID_ERROR_INVALID_STATE);

	swi_init_start(NULL);
	zassert_equal(sid_pal_swi_trigger(), SID_ERROR_NONE);
}

ZTEST_SUITE(swi_tests, NULL, NULL, swi_init_start, swi_stop_deinit, NULL);
```

## src/mock_zephyr.c
```c
/*
 * Copyright (c) 2022 Nordic Semiconductor ASA
 *
 * SPDX-License-Identifier: LicenseRef-Nordic-5-Clause
 */
void k_sem_give(struct k_sem *sem)
{
	ARG_UNUSED(sem);
}

int k_sem_take(struct k_sem *sem, k_timeout_t timeout)
{
	ARG_UNUSED(sem);
	ARG_UNUSED(timeout);
	return 0;
}
```
