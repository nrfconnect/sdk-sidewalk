## CMakeLists.txt
```
#
# Copyright (c) 2022 Nordic Semiconductor ASA
#
# SPDX-License-Identifier: LicenseRef-Nordic-5-Clause
#

cmake_minimum_required(VERSION 3.20.0)

find_package(Zephyr REQUIRED HINTS $ENV{ZEPHYR_BASE})
project(sidewalk_test_timer)

get_filename_component(SIDEWALK_BASE ${CMAKE_CURRENT_LIST_DIR}/../../.. ABSOLUTE)

target_sources(app PRIVATE
	src/main.c
	src/sid_timer_stub.c
	mock/critical_region.c
	${SIDEWALK_BASE}/subsys/sal/sid_pal/src/sid_timer.c
	${SIDEWALK_BASE}/subsys/sal/sid_pal/src/sid_uptime.c
	${SIDEWALK_BASE}/subsys/sal/sid_pal/src/zephyr_time.c
	${SIDEWALK_BASE}/subsys/sal/sid_pal/src/sid_assert.c
)

target_include_directories(app PRIVATE
	${SIDEWALK_BASE}/subsys/sal/sid_pal/include
	${SIDEWALK_BASE}/subsys/sal/sid_pal/sid_pal_types
	${SIDEWALK_BASE}/subsys/app_utils/config/include
)

target_link_libraries(app PRIVATE sid_sdk_component_pal_ifc)

zephyr_link_libraries(
	-Wl,--wrap=sid_pal_enter_critical_region
	-Wl,--wrap=sid_pal_exit_critical_region
)
```

## Kconfig
```
#
# Copyright (c) 2022 Nordic Semiconductor ASA
#
# SPDX-License-Identifier: LicenseRef-Nordic-5-Clause
#

config SIDEWALK_BUILD
	default y

config SIDEWALK_USE_PREBUILT_LIBRARIES
	default n

config SIDEWALK_PAL_ZEPHYR_LIBS_DISABLED
	default y

config SIDEWALK_TIMER
	default y

config SIDEWALK_UPTIME
	default y

config SIDEWALK_LOG
	default y
	imply LOG

config SIDEWALK_LOG_LEVEL
	default 0

config SIDEWALK_LOG_MSG_LENGTH_MAX
	default 80

source "Kconfig.zephyr"
```

## prj.conf
```kconfig
#
# Copyright (c) 2022 Nordic Semiconductor ASA
#
# SPDX-License-Identifier: LicenseRef-Nordic-4-Clause
#
CONFIG_UNITY=y
CONFIG_SIDEWALK_TIMER=y
```

## src/main.c
```c
/*
 * Copyright (c) 2022 Nordic Semiconductor ASA
 *
 * SPDX-License-Identifier: LicenseRef-Nordic-5-Clause
 */
#include <zephyr/ztest.h>

#include <sid_pal_timer_ifc.h>
#include <sid_pal_critical_region_ifc.h>

extern int test_enter_critical_call_count;
extern int test_exit_critical_call_count;

static sid_pal_timer_t *p_null_timer = NULL;
static sid_pal_timer_t test_timer;
static sid_pal_timer_t test_timer_2;
static int test_timer_arg;

static int timer_callback_cnt = 0;

static void before_test(void *fixture)
{
	ARG_UNUSED(fixture);

	timer_callback_cnt = 0;
	test_enter_critical_call_count = 0;
	test_exit_critical_call_count = 0;
}

ZTEST_SUITE(pal_timer, NULL, NULL, before_test, NULL, NULL);

static void timer_cb(void *arg, sid_pal_timer_t *originator)
{
	ARG_UNUSED(arg);
	ARG_UNUSED(originator);

	timer_callback_cnt++;
}

static void timer_init(void)
{
	zassert_equal(SID_ERROR_NONE, sid_pal_timer_init(&test_timer, timer_cb, &test_timer_arg));
	zassert_equal_ptr(&test_timer_arg, test_timer.callback_arg);
	zassert_equal_ptr(timer_cb, test_timer.callback);
}

static void timer_deinit(void)
{
	zassert_equal(SID_ERROR_NONE, sid_pal_timer_deinit(&test_timer));
	zassert_is_null(test_timer.callback_arg);
	zassert_is_null(test_timer.callback);
	zassert_false(sid_pal_timer_is_armed(&test_timer));
}

ZTEST(pal_timer, test_sid_pal_timer_init_deinit)
{
	zassert_equal(SID_ERROR_INVALID_ARGS, sid_pal_timer_init(NULL, NULL, NULL));
	zassert_equal(SID_ERROR_INVALID_ARGS, sid_pal_timer_init(&test_timer, NULL, NULL));
	zassert_equal(SID_ERROR_INVALID_ARGS, sid_pal_timer_init(p_null_timer, timer_cb, NULL));
	zassert_equal(SID_ERROR_INVALID_ARGS, sid_pal_timer_deinit(p_null_timer));

	zassert_equal(SID_ERROR_NONE, sid_pal_timer_init(&test_timer, timer_cb, NULL));

	zassert_is_null(test_timer.callback_arg);
	zassert_equal_ptr(timer_cb, test_timer.callback);

	zassert_equal(SID_ERROR_NONE, sid_pal_timer_deinit(&test_timer));

	zassert_is_null(test_timer.callback_arg);
	zassert_is_null(test_timer.callback);

	timer_init();
	timer_deinit();
}

ZTEST(pal_timer, test_sid_pal_timer_arm)
{
	struct sid_timespec when = { .tv_sec = 5 };
	struct sid_timespec period = { .tv_sec = 5 };

	zassert_equal(SID_ERROR_INVALID_ARGS,
		      sid_pal_timer_arm(p_null_timer, SID_PAL_TIMER_PRIO_CLASS_PRECISE, NULL,
					NULL));
	zassert_equal(SID_ERROR_INVALID_ARGS,
		      sid_pal_timer_arm(p_null_timer, SID_PAL_TIMER_PRIO_CLASS_PRECISE, &when,
					NULL));
	zassert_equal(SID_ERROR_INVALID_ARGS,
		      sid_pal_timer_arm(&test_timer, SID_PAL_TIMER_PRIO_CLASS_PRECISE, NULL, NULL));
	timer_init();

	zassert_equal(SID_ERROR_NONE,
		      sid_pal_timer_arm(&test_timer, SID_PAL_TIMER_PRIO_CLASS_PRECISE, &when,
					NULL));

	zassert_equal(SID_ERROR_INVALID_ARGS,
		      sid_pal_timer_arm(&test_timer, SID_PAL_TIMER_PRIO_CLASS_PRECISE, &when,
					NULL));

	zassert_equal(SID_ERROR_NONE, sid_pal_timer_cancel(&test_timer));
	zassert_equal(SID_ERROR_NONE,
		      sid_pal_timer_arm(&test_timer, SID_PAL_TIMER_PRIO_CLASS_PRECISE, &when,
					&period));

	zassert_equal(SID_ERROR_INVALID_ARGS,
		      sid_pal_timer_arm(&test_timer, SID_PAL_TIMER_PRIO_CLASS_PRECISE, &when,
					NULL));

	timer_deinit();
}

ZTEST(pal_timer, test_sid_pal_timer_is_armed)
{
	struct sid_timespec when = { .tv_sec = 5 };

	zassert_false(sid_pal_timer_is_armed(p_null_timer));
	zassert_false(sid_pal_timer_is_armed(&test_timer));

	timer_init();

	zassert_equal(SID_ERROR_NONE,
		      sid_pal_timer_arm(&test_timer, SID_PAL_TIMER_PRIO_CLASS_PRECISE, &when,
					NULL));
	zassert_true(sid_pal_timer_is_armed(&test_timer));
	zassert_equal(SID_ERROR_NONE, sid_pal_timer_cancel(&test_timer));
	zassert_false(sid_pal_timer_is_armed(&test_timer));

	zassert_equal(SID_ERROR_NONE,
		      sid_pal_timer_arm(&test_timer, SID_PAL_TIMER_PRIO_CLASS_LOWPOWER, &when,
					NULL));
	zassert_true(sid_pal_timer_is_armed(&test_timer));
	zassert_equal(SID_ERROR_NONE, sid_pal_timer_cancel(&test_timer));
	zassert_false(sid_pal_timer_is_armed(&test_timer));

	timer_deinit();
}

ZTEST(pal_timer, test_sid_pal_timer_cancel)
{
	struct sid_timespec when = { .tv_sec = 5 };
	struct sid_timespec period = { .tv_sec = 5 };

	zassert_equal(SID_ERROR_INVALID_ARGS, sid_pal_timer_cancel(p_null_timer));

	timer_init();

	zassert_equal(SID_ERROR_NONE,
		      sid_pal_timer_arm(&test_timer, SID_PAL_TIMER_PRIO_CLASS_PRECISE, &when,
					&period));
	zassert_equal(SID_ERROR_NONE, sid_pal_timer_cancel(&test_timer));

	timer_deinit();
}

ZTEST(pal_timer, test_sid_pal_timer_is_armed_deinit)
{
	struct sid_timespec when = { .tv_sec = 5 };

	timer_init();

	zassert_equal(SID_ERROR_NONE,
		      sid_pal_timer_arm(&test_timer, SID_PAL_TIMER_PRIO_CLASS_PRECISE, &when,
					NULL));
	zassert_true(sid_pal_timer_is_armed(&test_timer));

	timer_deinit();

	zassert_false(sid_pal_timer_is_armed(&test_timer));
}

ZTEST(pal_timer, test_sid_pal_timer_one_shot)
{
	struct sid_timespec when = { .tv_nsec = 50 * SID_TIME_NSEC_PER_USEC, .tv_sec = 0 };
	struct sid_timespec fake_time_low = { .tv_nsec = 40 * SID_TIME_NSEC_PER_USEC, .tv_sec = 0 };
	struct sid_timespec fake_time_expected = when;

	timer_init();

	zassert_false(sid_pal_timer_is_armed(&test_timer));
	zassert_equal(SID_ERROR_NONE,
		      sid_pal_timer_arm(&test_timer, SID_PAL_TIMER_PRIO_CLASS_PRECISE, &when,
					NULL));
	zassert_equal(0, timer_callback_cnt);

	sid_pal_timer_event_callback(NULL, &fake_time_low);

	zassert_equal(0, timer_callback_cnt);
	zassert_true(sid_pal_timer_is_armed(&test_timer));

	sid_pal_timer_event_callback(NULL, &fake_time_expected);

	zassert_equal(1, timer_callback_cnt);
	zassert_false(sid_pal_timer_is_armed(&test_timer));

	timer_deinit();
}

ZTEST(pal_timer, test_sid_pal_timer_two_timers)
{
	struct sid_timespec when_1 = { .tv_nsec = 50 * SID_TIME_NSEC_PER_USEC, .tv_sec = 0 };
	struct sid_timespec when_2 = { .tv_nsec = 80 * SID_TIME_NSEC_PER_USEC, .tv_sec = 0 };
	struct sid_timespec fake_time_low = { .tv_nsec = 40 * SID_TIME_NSEC_PER_USEC, .tv_sec = 0 };
	struct sid_timespec fake_time_expected = when_1;

	timer_init();
	zassert_equal(SID_ERROR_NONE, sid_pal_timer_init(&test_timer_2, timer_cb, &test_timer_arg));
	zassert_false(sid_pal_timer_is_armed(&test_timer));
	zassert_false(sid_pal_timer_is_armed(&test_timer_2));
	zassert_equal(SID_ERROR_NONE,
		      sid_pal_timer_arm(&test_timer, SID_PAL_TIMER_PRIO_CLASS_PRECISE, &when_1,
					NULL));
	zassert_equal(SID_ERROR_NONE,
		      sid_pal_timer_arm(&test_timer_2, SID_PAL_TIMER_PRIO_CLASS_PRECISE, &when_2,
					NULL));
	zassert_equal(0, timer_callback_cnt);

	sid_pal_timer_event_callback(NULL, &fake_time_low);

	zassert_equal(0, timer_callback_cnt);
	zassert_true(sid_pal_timer_is_armed(&test_timer));
	zassert_true(sid_pal_timer_is_armed(&test_timer_2));

	sid_pal_timer_event_callback(NULL, &fake_time_expected);

	zassert_equal(1, timer_callback_cnt);
	zassert_false(sid_pal_timer_is_armed(&test_timer));
	zassert_true(sid_pal_timer_is_armed(&test_timer_2));

	fake_time_expected = when_2;
	sid_pal_timer_event_callback(NULL, &fake_time_expected);

	zassert_equal(2, timer_callback_cnt);
	zassert_false(sid_pal_timer_is_armed(&test_timer_2));
	zassert_equal(SID_ERROR_NONE, sid_pal_timer_deinit(&test_timer_2));
	timer_deinit();
}
```

## src/sid_timer_stub.c
```c
/*
 * Copyright (c) 2022 Nordic Semiconductor ASA
 *
 * SPDX-License-Identifier: LicenseRef-Nordic-4-Clause
 */

/** @file sid_timer_stub.c
 *  @brief Stubs.
 */

#include <sid_time_types.h>
#include <sid_time_ops.h>

void sid_time_normalize(struct sid_timespec *time)
{
	if (SID_TIME_NSEC_PER_SEC > time->tv_nsec) {
		return;
	}

	while (time->tv_nsec >= SID_TIME_NSEC_PER_SEC) {
		time->tv_sec += 1;
		time->tv_nsec -= SID_TIME_NSEC_PER_SEC;
	}
}

void sid_time_add(struct sid_timespec *time_1, const struct sid_timespec *time_2)
{
	time_1->tv_sec += time_2->tv_sec;
	time_1->tv_nsec += time_2->tv_nsec;

	sid_time_normalize(time_1);
}

void sid_time_sub(struct sid_timespec *time_1, const struct sid_timespec *time_2)
{
	struct sid_timespec *tmp_time = (struct sid_timespec *)time_2;

	sid_time_normalize(tmp_time);

	if (time_1->tv_nsec < tmp_time->tv_nsec) {
		time_1->tv_sec -= 1;
		time_1->tv_nsec += SID_TIME_NSEC_PER_SEC;
	}

	time_1->tv_sec -= tmp_time->tv_sec;
	time_1->tv_nsec -= tmp_time->tv_nsec;

	sid_time_normalize(time_1);
}

bool sid_time_gt(const struct sid_timespec *time_1, const struct sid_timespec *time_2)
{
	if ((time_1->tv_sec > time_2->tv_sec) ||
	    (time_1->tv_sec == time_2->tv_sec && time_1->tv_nsec > time_2->tv_nsec)) {
		return true;
	}

	return false;
}

bool sid_time_is_infinity(const struct sid_timespec *time)
{
	if (time->tv_sec == SID_TIME_INFINITY.tv_sec &&
	    time->tv_nsec == SID_TIME_INFINITY.tv_nsec) {
		return true;
	}
	return false;
}
```
