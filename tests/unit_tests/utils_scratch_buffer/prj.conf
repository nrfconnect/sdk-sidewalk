## CMakeLists.txt
```
#
#  Copyright (c) 2023 Nordic Semiconductor ASA
#
#  SPDX-License-Identifier: LicenseRef-Nordic-5-Clause
#

cmake_minimum_required(VERSION 3.20.0)
set(CMAKE_EXPORT_COMPILE_COMMANDS ON)
set(BOARD unit_testing)
project(scratch_buffer)
find_package(Zephyr COMPONENTS unittest REQUIRED HINTS $ENV{ZEPHYR_BASE})
set(CMAKE_C_FLAGS "${CMAKE_C_FLAGS} -g3 -O0")
set(SIDEWALK_BASE $ENV{ZEPHYR_BASE}/../sidewalk)

target_sources(testbinary PRIVATE src/main.c ${SIDEWALK_BASE}/utils/scratch_buffer/scratch_buffer.c mock/log_minimal.c)

target_include_directories(testbinary PRIVATE ${SIDEWALK_BASE}/utils/scratch_buffer  ${SIDEWALK_BASE}/subsys/hal/include)
```

## prj.conf
```kconfig
#
# Copyright (c) 2022 Nordic Semiconductor ASA
#
# SPDX-License-Identifier: LicenseRef-Nordic-5-Clause
#

CONFIG_ZTEST=y
```

## src/main.c
```c
/*
 * Copyright (c) 2024 Nordic Semiconductor ASA
 *
 * SPDX-License-Identifier: LicenseRef-Nordic-5-Clause
 */

#include <scratch_buffer.h>

#include <zephyr/ztest.h>
#include <zephyr/fff.h>
#include <stdlib.h>

DEFINE_FFF_GLOBALS;

FAKE_VALUE_FUNC(void *, sid_hal_malloc, size_t);
FAKE_VOID_FUNC(sid_hal_free, void *);

static void *setup(void)
{
	RESET_FAKE(sid_hal_malloc);
	RESET_FAKE(sid_hal_free);

	FFF_RESET_HISTORY();

	sid_hal_malloc_fake.custom_fake = malloc;
	sid_hal_free_fake.custom_fake = free;

	return NULL;
}

ZTEST_SUITE(my_suite, NULL, setup, NULL, NULL, NULL);

ZTEST(my_suite, test_scratch_buffer_basic)
{
	uint32_t id = 1;
	size_t size = 64;
	void *p = NULL;
	uint8_t test[size];
	memset(test, 0xAA, size);

	scratch_buffer_init();

	p = scratch_buffer_create(id, size);
	zassert_equal(sid_hal_malloc_fake.call_count, 1);
	zassert_equal(sid_hal_malloc_fake.arg0_history[0], size);
	zassert_not_null(p);

	scratch_buffer_remove(id);
	zassert_equal(sid_hal_free_fake.call_count, 1);
}
```
