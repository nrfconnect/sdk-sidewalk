## CMakeLists.txt
```
#
# Copyright (c) 2022 Nordic Semiconductor ASA
#
# SPDX-License-Identifier: LicenseRef-Nordic-5-Clause
#

cmake_minimum_required(VERSION 3.20.0)

add_definitions(-DHALO_ENABLE_DIAGNOSTICS=1)
add_definitions(-DDEV_ID_REG=0x33AABB99)

find_package(Zephyr REQUIRED HINTS $ENV{ZEPHYR_BASE})
project(sidewalk_test_mfg_storage)

cmock_handle(${ZEPHYR_BASE}/include/zephyr/drivers/flash.h zephyr/drivers)

# add test file
FILE(GLOB app_sources src/*.c)
target_sources(app PRIVATE 
        ${app_sources} 
        ${ZEPHYR_BASE}/../sidewalk/subsys/sal/sid_pal/src/sid_mfg_storage.c
)

target_include_directories(app PRIVATE ${ZEPHYR_BASE}/../sidewalk/subsys/sal/common/sid_pal_ifc
        ${ZEPHYR_BASE}/../sidewalk/subsys/sal/common/sid_ifc
        ${ZEPHYR_BASE}/../sidewalk/subsys/config/common/include/)

# generate runner for the test
test_runner_generate(${app_sources})
```

## Kconfig
```
#
# Copyright (c) 2022 Nordic Semiconductor ASA
#
# SPDX-License-Identifier: LicenseRef-Nordic-5-Clause
#

# config SIDEWALK_BUILD
# 	default y

config SIDEWALK_MFG_STORAGE
	default y
	imply FLASH

config SIDEWALK_MFG_STORAGE_DIAGNOSTIC
	default y

source "Kconfig.zephyr"
```

## prj.conf
```kconfig
#
# Copyright (c) 2022 Nordic Semiconductor ASA
#
# SPDX-License-Identifier: LicenseRef-Nordic-4-Clause
#
CONFIG_UNITY=y
CONFIG_SIDEWALK_MFG_STORAGE=y
```

## src/main.c
```c
/*
 * Copyright (c) 2022 Nordic Semiconductor ASA
 *
 * SPDX-License-Identifier: LicenseRef-Nordic-5-Clause
 */
#include <unity.h>
#include <sid_pal_mfg_store_ifc.h>
#include <sid_error.h>
#include <zephyr/drivers/cmock_flash.h>
#include <string.h>

static uint8_t test_data_buffer[512];

void setUp(void)
{
}

/******************************************************************
* sid_pal_mfg_store_ifc
* ****************************************************************/
void test_sid_pal_mfg_storage_no_init(void)
{
	uint8_t read_buffer[SID_PAL_MFG_STORE_VERSION_SIZE] = { 0 };

	TEST_ASSERT_EQUAL(SID_ERROR_UNINITIALIZED,
			  sid_pal_mfg_store_write(SID_PAL_MFG_STORE_VERSION, read_buffer,
						  SID_PAL_MFG_STORE_VERSION_SIZE));
	TEST_ASSERT_EQUAL(SID_ERROR_UNINITIALIZED, sid_pal_mfg_store_erase());
	TEST_ASSERT_FALSE(sid_pal_mfg_store_is_empty());
	memset(read_buffer, 0xAA, SID_PAL_MFG_STORE_VERSION_SIZE);
	memset(test_data_buffer, 0xAA, SID_PAL_MFG_STORE_VERSION_SIZE);
	sid_pal_mfg_store_read(SID_PAL_MFG_STORE_VERSION, read_buffer,
			       SID_PAL_MFG_STORE_VERSION_SIZE);
	TEST_ASSERT_EQUAL_HEX8_ARRAY(read_buffer, test_data_buffer, SID_PAL_MFG_STORE_VERSION_SIZE);
}

void test_sid_pal_mfg_storage_init(void)
{
	static const sid_pal_mfg_store_region_t mfg_store_region = {
		.addr_start = 0,
		.addr_end = 0x1000,
	};

	sid_pal_mfg_store_init(mfg_store_region);
	__cmock_flash_erase_ExpectAndReturn(
		DEVICE_DT_GET_OR_NULL(DT_CHOSEN(zephyr_flash_controller)), 0, 0x1000, 0);
	TEST_ASSERT_EQUAL(0, sid_pal_mfg_store_erase());
}

void test_sid_pal_mfg_storage_write(void)
{
	uint8_t write_buff[SID_PAL_MFG_STORE_MAX_FLASH_WRITE_LEN] = { 0 };

	TEST_ASSERT_EQUAL(SID_ERROR_INVALID_ARGS,
			  sid_pal_mfg_store_write(SID_PAL_MFG_STORE_VERSION, write_buff, 0));
	TEST_ASSERT_EQUAL(SID_ERROR_OUT_OF_RESOURCES,
			  sid_pal_mfg_store_write(SID_PAL_MFG_STORE_VERSION, write_buff, 128));
	TEST_ASSERT_EQUAL(SID_ERROR_INCOMPATIBLE_PARAMS,
			  sid_pal_mfg_store_write(SID_PAL_MFG_STORE_VERSION, write_buff, 3));
	TEST_ASSERT_EQUAL(SID_ERROR_NOT_FOUND,
			  sid_pal_mfg_store_write(999, write_buff, SID_PAL_MFG_STORE_VERSION_SIZE));
	TEST_ASSERT_EQUAL(SID_ERROR_NULL_POINTER,
			  sid_pal_mfg_store_write(SID_PAL_MFG_STORE_VERSION, NULL,
						  SID_PAL_MFG_STORE_VERSION_SIZE));

	__cmock_flash_write_ExpectAnyArgsAndReturn(0);
	TEST_ASSERT_EQUAL(0, sid_pal_mfg_store_write(SID_PAL_MFG_STORE_VERSION, write_buff,
						     SID_PAL_MFG_STORE_VERSION_SIZE));
}

void test_sid_pal_mfg_storage_dev_id_get(void)
{
	uint8_t dev_id[SID_PAL_MFG_STORE_DEVID_SIZE] = { 0 };

	memset(dev_id, 0x00, sizeof(dev_id));

	TEST_ASSERT_FALSE(sid_pal_mfg_store_dev_id_get(dev_id));
	TEST_ASSERT_EQUAL(0xBF, dev_id[0]);
	// DEV_ID_REG=0x33AABB99
	TEST_ASSERT_EQUAL(0x33, dev_id[1]);
	TEST_ASSERT_EQUAL(0xAA, dev_id[2]);
	TEST_ASSERT_EQUAL(0xBB, dev_id[3]);
	TEST_ASSERT_EQUAL(0x99, dev_id[4]);
}

void test_sid_pal_mfg_storage_sn_get(void)
{
	uint8_t serial_num[SID_PAL_MFG_STORE_SERIAL_NUM_SIZE] = { 0 };
	uint8_t empty_serial[SID_PAL_MFG_STORE_SERIAL_NUM_SIZE] = { 0 };
	memset(empty_serial, 0xFF, SID_PAL_MFG_STORE_SERIAL_NUM_SIZE);

	// No serial number.
	__cmock_flash_read_ExpectAndReturn(
		DEVICE_DT_GET_OR_NULL(DT_CHOSEN(zephyr_flash_controller)), 0, NULL,
		SID_PAL_MFG_STORE_SERIAL_NUM_SIZE, 0);
	__cmock_flash_read_IgnoreArg_data();
	__cmock_flash_read_IgnoreArg_offset();
	__cmock_flash_read_ReturnMemThruPtr_data(empty_serial, SID_PAL_MFG_STORE_SERIAL_NUM_SIZE);
	TEST_ASSERT_FALSE(sid_pal_mfg_store_serial_num_get(serial_num));
}

/* It is required to be added to each test. That is because unity is using
 * different main signature (returns int) and zephyr expects main which does
 * not return value.
 */
extern int unity_main(void);

int main(void)
{
	return unity_main();
}
```
