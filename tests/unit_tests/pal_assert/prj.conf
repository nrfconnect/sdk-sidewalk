## CMakeLists.txt
```
#
# Copyright (c) 2022 Nordic Semiconductor ASA
#
# SPDX-License-Identifier: LicenseRef-Nordic-5-Clause
#

cmake_minimum_required(VERSION 3.20.0)

find_package(Zephyr COMPONENTS unittest REQUIRED HINTS $ENV{ZEPHYR_BASE})
project(sidewalk_test_assert)

get_filename_component(SIDEWALK_BASE ${CMAKE_CURRENT_LIST_DIR}/../../.. ABSOLUTE)
include(${SIDEWALK_BASE}/tests/cmake/sidewalk_test_ifc.cmake)

# Workaround on build system not able to find this definition (in kernel.h)
add_definitions(-DARCH_STACK_PTR_ALIGN=8)
# add test file
target_include_directories(testbinary PRIVATE
	${SIDEWALK_BASE}/subsys/sal/sid_pal/include
)

sidewalk_link_test_ifc(testbinary ${SIDEWALK_BASE} ${CMAKE_CURRENT_BINARY_DIR} sid_pal_assert_ifc)
target_sources(testbinary PRIVATE 
    ${SIDEWALK_BASE}/subsys/sal/sid_pal/src/sid_assert.c
    src/main.c
)
```

## Kconfig
```
#
# Copyright (c) 2022 Nordic Semiconductor ASA
#
# SPDX-License-Identifier: LicenseRef-Nordic-5-Clause
#
config SIDEWALK_BUILD
	default y

config SIDEWALK_PAL_ZEPHYR_LIBS_DISABLED
	default y

config SIDEWALK_LOG_LEVEL
	default 0

source "Kconfig.zephyr"
```

## prj.conf
```kconfig
#
# Copyright (c) 2022 Nordic Semiconductor ASA
#
# SPDX-License-Identifier: LicenseRef-Nordic-5-Clause
#
CONFIG_ZTEST=y
CONFIG_ASSERT=y
```

## src/main.c
```c
/*
 * Copyright (c) 2022 Nordic Semiconductor ASA
 *
 * SPDX-License-Identifier: LicenseRef-Nordic-5-Clause
 */

#include <sid_pal_assert_ifc.h>
#include <stdbool.h>
#include <zephyr/ztest.h>
#include <zephyr/fff.h>

DEFINE_FFF_GLOBALS;

FAKE_VOID_FUNC_VARARG(z_log_minimal_printk, const char *, ...);

static void suite_setup(void *f)
{
	RESET_FAKE(z_log_minimal_printk);
}

/******************************************************************
* sid_pal_assert_ifc
* ****************************************************************/
static bool should_assert;
void assert_post_action(const char *file, unsigned int line)
{
	ARG_UNUSED(file);
	ARG_UNUSED(line);

	if (should_assert) {
		should_assert = false;
		ztest_test_pass();
	}
	ztest_test_fail();
}

ZTEST(assert_tests, test_sid_pal_assert_true)
{
	should_assert = false;
	SID_PAL_ASSERT(true);
	zassert_false(should_assert, "No assert when it should be.");
}

ZTEST(assert_tests, test_sid_pal_assert_false)
{
	should_assert = true;
	SID_PAL_ASSERT(false);
	zassert_false(should_assert, "Asserted, but should not.");
}

ZTEST_SUITE(assert_tests, NULL, NULL, suite_setup, NULL, NULL);
```
