## CMakeLists.txt
```
#
#  Copyright (c) 2023 Nordic Semiconductor ASA
#
#  SPDX-License-Identifier: LicenseRef-Nordic-5-Clause
#

cmake_minimum_required(VERSION 3.20.0)
set(CMAKE_EXPORT_COMPILE_COMMANDS ON)
set(BOARD unit_testing)
project(state_notifier)
find_package(Zephyr COMPONENTS unittest REQUIRED HINTS $ENV{ZEPHYR_BASE})

get_filename_component(SIDEWALK_BASE ${CMAKE_CURRENT_LIST_DIR}/../../.. ABSOLUTE)

set(CMAKE_C_FLAGS "${CMAKE_C_FLAGS} -g3 -O0")
set(CMAKE_CXX_FLAGS "${CMAKE_CXX_FLAGS} -g3 -O0")

target_sources(testbinary PRIVATE
	src/main.c
	${SIDEWALK_BASE}/samples/sid_end_device/src/cli/app_shell.c
	${ZEPHYR_BASE}/lib/utils/hex.c
	mock/sidewalk_version.c
)

add_definitions(--include ztest.h)

target_include_directories(testbinary PRIVATE
	${SIDEWALK_BASE}/samples/sid_end_device/include
	${SIDEWALK_BASE}/subsys/sal/common/public/sid_ifc/sid_api
	${SIDEWALK_BASE}/subsys/sal/common/public/sid_ifc/sid_900_cfg
	${SIDEWALK_BASE}/subsys/sal/common/public/sid_ifc/sid_ble_cfg
	${SIDEWALK_BASE}/subsys/sal/common/public/sid_ifc/sid_bulk_data_transfer_api
	${SIDEWALK_BASE}/subsys/sal/common/public/sid_ifc/sid_detect_unwanted_location_tracker_api
	${SIDEWALK_BASE}/subsys/sal/common/public/sid_ifc/sid_device_capabilities
	${SIDEWALK_BASE}/subsys/sal/common/public/sid_ifc/sid_device_information_api
	${SIDEWALK_BASE}/subsys/sal/common/public/sid_ifc/sid_diag_log_cfg
	${SIDEWALK_BASE}/subsys/sal/common/public/sid_ifc/sid_error
	${SIDEWALK_BASE}/subsys/sal/common/public/sid_ifc/sid_location
	${SIDEWALK_BASE}/subsys/sal/common/public/sid_ifc/sid_on_dev_cert
	${SIDEWALK_BASE}/subsys/sal/common/public/sid_ifc/sid_reset_info
	${SIDEWALK_BASE}/subsys/sal/common/public/sid_ifc/sid_sdk_config
	${SIDEWALK_BASE}/subsys/sal/common/public/sid_ifc/sid_sdk_version
	${SIDEWALK_BASE}/subsys/sal/common/public/sid_ifc/sid_setup_failure
	${SIDEWALK_BASE}/subsys/sal/common/public/sid_ifc/sid_time_sync_config
	${SIDEWALK_BASE}/subsys/sal/common/public/sid_pal_ifc/assert
	${SIDEWALK_BASE}/subsys/sal/common/public/sid_pal_ifc/ble_adapter
	${SIDEWALK_BASE}/subsys/sal/common/public/sid_pal_ifc/common
	${SIDEWALK_BASE}/subsys/sal/common/public/sid_pal_ifc/critical_region
	${SIDEWALK_BASE}/subsys/sal/common/public/sid_pal_ifc/crypto
	${SIDEWALK_BASE}/subsys/sal/common/public/sid_pal_ifc/delay
	${SIDEWALK_BASE}/subsys/sal/common/public/sid_pal_ifc/dult
	${SIDEWALK_BASE}/subsys/sal/common/public/sid_pal_ifc/gpio
	${SIDEWALK_BASE}/subsys/sal/common/public/sid_pal_ifc/gnss
	${SIDEWALK_BASE}/subsys/sal/common/public/sid_pal_ifc/log
	${SIDEWALK_BASE}/subsys/sal/common/public/sid_pal_ifc/mfg_store
	${SIDEWALK_BASE}/subsys/sal/common/public/sid_pal_ifc/radio
	${SIDEWALK_BASE}/subsys/sal/common/public/sid_pal_ifc/serial_bus_ifc
	${SIDEWALK_BASE}/subsys/sal/common/public/sid_pal_ifc/storage_kv
	${SIDEWALK_BASE}/subsys/sal/common/public/sid_pal_ifc/swi
	${SIDEWALK_BASE}/subsys/sal/common/public/sid_pal_ifc/temperature
	${SIDEWALK_BASE}/subsys/sal/common/public/sid_pal_ifc/timer
	${SIDEWALK_BASE}/subsys/sal/common/public/sid_pal_ifc/uptime
	${SIDEWALK_BASE}/subsys/sal/common/public/sid_pal_ifc/wifi
	${SIDEWALK_BASE}/subsys/app_utils/config/include
	${SIDEWALK_BASE}/subsys/sal/sid_pal/sid_pal_types
	${SIDEWALK_BASE}/subsys/app_utils/hal/include
	${SIDEWALK_BASE}/utils/include
	.
	src
)
```

## Kconfig
```
#
# Copyright (c) 2022 Nordic Semiconductor ASA
#
# SPDX-License-Identifier: LicenseRef-Nordic-5-Clause
#

config SHELL_CMD_BUFF_SIZE
	default 1024
config LOG
	default false

config SIDEWALK_LOG_LEVEL
	default 0


config SBDT_MAX_PARALLEL_TRANSFERS
	int
	default 3

config SIDEWALK_GENERATE_VERSION_MINIMAL
	bool
	default n

config SIDEWALK_BLE_ADV_INT_FAST
	int "Fast advertise interval in ms"
	default 160

config SIDEWALK_BLE_ADV_INT_SLOW
	int "Slow advertise interval in ms"
	default 1000

config SIDEWALK_BLE_ADV_INT_TRANSITION
	int "Duration of fast advertisement after sid_start in seconds"
	default 30

config BT_PERIPHERAL_PREF_LATENCY
	int "Preferred slave latency"
	default 0

config BT_PERIPHERAL_PREF_TIMEOUT
	int "Preferred supervision timeout in 10 ms units"
	default 400

source "Kconfig.zephyr"
```

## prj.conf
```kconfig
#
# Copyright (c) 2023 Nordic Semiconductor ASA
#
# SPDX-License-Identifier: LicenseRef-Nordic-5-Clause
#
CONFIG_ZTEST_NEW_API=y
```

## src/app_version.h
```c
/*
 * Copyright (c) 2024 Nordic Semiconductor ASA
 *
 * SPDX-License-Identifier: LicenseRef-Nordic-5-Clause
 */

// clang-format off

#ifndef _APP_VERSION_H_
#define _APP_VERSION_H_

/*  values come from cmake/version.cmake
 * BUILD_VERSION related  values will be 'git describe',
 * alternatively user defined BUILD_VERSION.
 */

/* #undef ZEPHYR_VERSION_CODE */
/* #undef ZEPHYR_VERSION */

#define APPVERSION                   0x2076300
#define APP_VERSION_NUMBER           0x20763
#define APP_VERSION_MAJOR            2
#define APP_VERSION_MINOR            7
#define APP_PATCHLEVEL               99
#define APP_TWEAK                    0
#define APP_VERSION_STRING           "2.7.99"
#define APP_VERSION_EXTENDED_STRING  "2.7.99+0"
#define APP_VERSION_TWEAK_STRING     "2.7.99+0"

#define APP_BUILD_VERSION v2.7.0-32-g9ea02813749e


#endif /* _APP_VERSION_H_ */

// clang-format on
```
