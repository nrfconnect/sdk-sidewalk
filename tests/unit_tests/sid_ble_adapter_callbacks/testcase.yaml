## tests/unit_tests/sid_ble_adapter_callbacks/testcase.yaml
```yaml
tests:
  sidewalk.test.unit.ble_adapter_callbacks:
    sysbuild: false
    tags: Sidewalk
    type: unit
```

## tests/unit_tests/sid_ble_advert/Kconfig
```kconfig
#
# Copyright (c) 2022 Nordic Semiconductor ASA
#
# SPDX-License-Identifier: LicenseRef-Nordic-5-Clause
#
config SIDEWALK_BUILD
	default y

config SIDEWALK_LOG_LEVEL
	default 0

config BT_ID_MAX
	default 2

config BT_APP_IFC
	default y

module = SIDEWALK_BLE_ADAPTER
module-str = Sidewalk BLE interface
source "${ZEPHYR_BASE}/subsys/logging/Kconfig.template.log_config"

config SIDEWALK_BLE_ADV_INT_PRECISION
	int "test value for Sidewalk configuration macro"
	default 5

config SIDEWALK_BLE_ADV_INT_FAST
	int "test value for Sidewalk configuration macro"
	default 160

config SIDEWALK_BLE_ADV_INT_SLOW
	int "test value for Sidewalk configuration macro"
	default 1000

config SIDEWALK_BLE_ADV_INT_TRANSITION
	int "test value for Sidewalk configuration macro"
	default 30


config SIDEWALK_BLE_NAME
	string "BLE name adverticed for Sidewalk"
	default "SID_APP"

source "Kconfig.zephyr"
```

## tests/unit_tests/sid_ble_advert/testcase.yaml
```yaml
tests:
  sidewalk.test.unit.ble_advertising:
    sysbuild: true
    platform_allow: native_posix
    tags: Sidewalk
    integration_platforms:
      - native_posix
```

## tests/unit_tests/sid_ble_connection/testcase.yaml
```yaml
tests:
  sidewalk.test.unit.ble_connection:
    sysbuild: true
    platform_allow: native_sim
    tags: Sidewalk
    integration_platforms:
      - native_sim
```

## tests/unit_tests/sid_ble_service/testcase.yaml
```yaml
tests:
  sidewalk.test.unit.sid_ble_service:
    sysbuild: true
    platform_allow: native_sim
    tags: Sidewalk
    integration_platforms:
      - native_sim
```

## tests/unit_tests/sid_dut_shell/testcase.yaml
```yaml
tests:
  sidewalk.test.unit.sid_dut_shell:
    sysbuild: false
    tags: Sidewalk
    type: unit
```

## tests/unit_tests/sid_pal_gpio/testcase.yaml
```yaml
tests:
  sidewalk.test.unit.gpio:
    sysbuild: true
    platform_allow: native_sim
    tags: Sidewalk
    integration_platforms:
      - native_sim
```

## tests/unit_tests/sid_pal_gpio_irq_handler/Kconfig
```kconfig
#
# Copyright (c) 2022 Nordic Semiconductor ASA
#
# SPDX-License-Identifier: LicenseRef-Nordic-4-Clause
#
config SIDEWALK_LOG_LEVEL
    default 0

config SIDEWALK_BLE_ADAPTER_LOG_LEVEL
    default 0

config SIDEWALK_GPIO_IRQ_PRIORITY
	default 1

config SIDEWALK_GPIO_IRQ_STACK_SIZE
	default 2048

source "Kconfig.zephyr"
```

## tests/unit_tests/sid_pal_gpio_irq_handler/testcase.yaml
```yaml
tests:
  sidewalk.unit_tests.gpio_irq_handler:
    platform_allow: native_posix
    tags: Sidewalk
    integration_platforms:
      - native_posix
```

## tests/unit_tests/sid_pal_gpio_utils/testcase.yaml
```yaml
tests:
  sidewalk.unit_tests.gpio_utils:
    platform_allow: native_posix
    tags: Sidewalk
    integration_platforms:
      - native_posix
```

## tests/unit_tests/state_notifier/testcase.yaml
```yaml
tests:
  sidewalk.test.unit.state_notifier:
    sysbuild: false
    tags: Sidewalk
    type: unit
```

## tests/unit_tests/tlv/testcase.yaml
```yaml
tests:
  sidewalk.test.unit.tlv:
    sysbuild: false
    tags: Sidewalk
    type: unit
```

## tests/unit_tests/utils_scratch_buffer/testcase.yaml
```yaml
tests:
  sidewalk.unit_tests.utils.scratch_buffer:
    sysbuild: false
    tags: Sidewalk
    type: unit
```

## tests/validation/crypto/testcase.yaml
```yaml
tests:
  sidewalk.sid_validation.pal_crypto:
    sysbuild: true
    platform_allow:
      - nrf52840dk/nrf52840
      - nrf5340dk/nrf5340/cpuapp
      - nrf54l15dk/nrf54l15/cpuapp
    tags: Sidewalk
    integration_platforms:
      - nrf52840dk/nrf52840
      - nrf5340dk/nrf5340/cpuapp
      - nrf54l15dk/nrf54l15/cpuapp
```

## tests/validation/storage_kv/testcase.yaml
```yaml
tests:
  sidewalk.test.integration.pal_storage_kv:
    sysbuild: true
    platform_allow:
      - nrf52840dk/nrf52840
      - nrf54l15dk/nrf54l15/cpuapp
    integration_platforms:
      - nrf54l15dk/nrf54l15/cpuapp
    tags: Sidewalk
```

## tests_new/integration/delay/boards/native_sim.conf
```kconfig
#
# Copyright (c) 2024 Nordic Semiconductor ASA
#
# SPDX-License-Identifier: LicenseRef-Nordic-5-Clause
#

# Changed emulator default tick rate from 100 Hz to 10 kHz
# Test requires millisecond precision in timing
CONFIG_SYS_CLOCK_TICKS_PER_SEC=10000
```

## tests_new/integration/interrupts/Kconfig
```kconfig
#
# Copyright (c) 2022 Nordic Semiconductor ASA
#
# SPDX-License-Identifier: LicenseRef-Nordic-5-Clause
#
config SIDEWALK_BUILD
	default y

config SIDEWALK_USE_PREBUILTS
	default y

config SIDEWALK_SW_INTERRUPTS
	default y

config SIDEWALK_SWI_PRIORITY
	int
	default 0

config SIDEWALK_SWI_STACK_SIZE
	int
	default 4096

config SIDEWALK_LOG_LEVEL
	default 0

source "Kconfig.zephyr"
source "${ZEPHYR_BASE}/../sidewalk/Kconfig.dependencies"
```

## tests_new/integration/timer/testcase.yaml
```yaml
tests:
  sidewalk.test.integration.timer:
    sysbuild: true
    tags: Sidewalk
    platform_allow:
      - native_sim
      - nrf52840dk/nrf52840
      - nrf5340dk/nrf5340/cpuapp
      - nrf54l15dk/nrf54l15/cpuapp
      - nrf54l15dk/nrf54l15/cpuapp/ns
      - nrf54l15dk/nrf54l10/cpuapp
    integration_platforms:
      - native_sim
      - nrf52840dk/nrf52840
      - nrf5340dk/nrf5340/cpuapp
      - nrf54l15dk/nrf54l15/cpuapp
      - nrf54l15dk/nrf54l15/cpuapp/ns
      - nrf54l15dk/nrf54l10/cpuapp
```

## utils/Kconfig
```kconfig
#
# Copyright (c) 2022 Nordic Semiconductor ASA
#
# SPDX-License-Identifier: LicenseRef-Nordic-5-Clause
#

rsource "tlv/Kconfig"
rsource "buttons_utils/Kconfig"
rsource "state_notifier/Kconfig"
rsource "settings_utils/Kconfig"
rsource "sidewalk_dfu/Kconfig"
```

## utils/nanopb/Kconfig
```kconfig
#
# Copyright (c) 2022 Nordic Semiconductor ASA
#
# SPDX-License-Identifier: LicenseRef-Nordic-5-Clause
#

config SIDEWALK_NANOPB
	bool "Nanopb headers to use with Sidewalk library [EXPERIMENTAL]"
	depends on SIDEWALK
	select EXPERIMENTAL
	help
	  Nanopb headers to use nanopb from the Sidewalk library.
	  This option is experimental and may be removed in the future.
```

## utils/settings_utils/Kconfig
```kconfig
#
# Copyright (c) 2022 Nordic Semiconductor ASA
#
# SPDX-License-Identifier: LicenseRef-Nordic-5-Clause
#

menuconfig SIDEWALK_SETTINGS_UTILS
	bool "Enables Sidewalk settings utils module"
	default SIDEWALK
	help
		Sidewalk settings utils allows samples to
		keep data in non-volatile storage.

if SIDEWALK_SETTINGS_UTILS

config PERSISTENT_LINK_MASK_SETTINGS_KEY
	string
	default "application/settings/link_mask"
	help
	  Key for settings to store last Sidewalk link mode in flash for next reboot

config DEPRECATED_DFU_FLAG_SETTINGS_KEY
	bool "Enable Key for settings to store DFU flag in flash for next reboot [DEPRICATED]"

if DEPRECATED_DFU_FLAG_SETTINGS_KEY
config DFU_FLAG_SETTINGS_KEY
	string
	default "application/settings/DFU_mode"
	help
	  Note: [DEPRICATED]
	  Key for settings to store DFU flag in flash for next reboot
	  If value is set to True, the applicaiton will start in DFU mode after reset
	  Deprecated in favor of DFU state in Sidewalk samples application.

endif # DEPRECATED_DFU_FLAG_SETTINGS_KEY
endif # SIDEWALK_SETTINGS_UTILS
```

## utils/sidewalk_dfu/Kconfig
```kconfig
#
# Copyright (c) 2022 Nordic Semiconductor ASA
#
# SPDX-License-Identifier: LicenseRef-Nordic-5-Clause
#

menuconfig SIDEWALK_DFU
	bool "DFU service in Sidewalk sample"

if SIDEWALK_DFU

config SIDEWALK_DFU_BOOTLOADER
	bool "Bootloder configuration for Sidewalk sample"
	default SIDEWALK_DFU
	imply IMG_MANAGER
	imply BOOTLOADER_MCUBOOT
	imply FLASH
	imply NET_BUF
	imply ZCBOR
	imply CRC
	imply STREAM_FLASH
	imply FLASH_MAP
	imply MCUMGR_TRANSPORT_BT_REASSEMBLY
	imply FLASH_PAGE_LAYOUT
	imply EXTRA_EXCEPTION_INFO

config SIDEWALK_DFU_SERVICE_BLE
	bool "DFU sericve over BLE"
	default SIDEWALK_DFU
	imply MCUMGR
	imply MCUMGR_GRP_IMG
	imply MCUMGR_GRP_OS
	imply MCUMGR_MGMT_NOTIFICATION_HOOKS
	imply MCUMGR_GRP_IMG_UPLOAD_CHECK_HOOK
	imply MCUMGR_GRP_IMG_STATUS_HOOKS
	imply MCUMGR_GRP_OS_RESET_HOOK
	imply MCUMGR_SMP_COMMAND_STATUS_HOOKS
	imply MCUMGR_TRANSPORT_BT
	imply MCUMGR_TRANSPORT_BT_CONN_PARAM_CONTROL
	help
	  Use Zephyr SMP Service as image upload methode for Sidewalk.

config SIDEWALK_DFU_IMG_UTILS
	bool "Utils for dfu images management"
	help
	  Use nRF Connect SDK muli image as image write methode for Sidewalk.

if SIDEWALK_DFU_SERVICE_BLE

config DFU_UPLOAD_START_TIMEOUT
	int
	default 5
	help
	  Time in minutes in which the DFU has to start, after this time the device will reboot and exit DFU mode

config DFU_UPLOAD_COMPLETE_TIMEOUT
	int
	default 60
	help
	  Time in minutes in which the DFU has to complete (starting from entering to DFU mode)
	  if it do not complete in this time, the device will reboot and exit DFU mode


choice MCUMGR_TRANSPORT_BT_PERM
	default MCUMGR_TRANSPORT_BT_PERM_RW
endchoice

config MCUMGR_TRANSPORT_BT_DYNAMIC_SVC_REGISTRATION
	default n

endif # SIDEWALK_DFU_SERVICE_BLE

if SIDEWALK_DFU_IMG_UTILS

config SIDEWALK_DFU_IMG_BUFFER_SIZE
	int "Sidewalk dfu image utils chunk buffer size"
	default 1024
	help
	  Chunk size for dfu image utils. Size in bytes.
	  Default value choosen for Sidewalk Bulk Data Transfer.

endif # SIDEWALK_DFU_IMG_UTILS

endif # SIDEWALK_DFU
```

## utils/state_notifier/Kconfig
```kconfig
#
# Copyright (c) 2022 Nordic Semiconductor ASA
#
# SPDX-License-Identifier: LicenseRef-Nordic-5-Clause
#

config STATE_NOTIFIER
	bool 
	default SIDEWALK
	help
	  Stete notifier module for Sidewalk application.

if STATE_NOTIFIER

config STATE_NOTIFIER_HANDLER_MAX
	int
	default 2 if LOG
	default 1
	help
	  Maximum number of the notifier listeners.

endif # STATE_NOTIFIER
```

## utils/tlv/Kconfig
```kconfig
#
# Copyright (c) 2022 Nordic Semiconductor ASA
#
# SPDX-License-Identifier: LicenseRef-Nordic-5-Clause
#

menuconfig SIDEWALK_TLV
        bool "Sidewalk TLV utils module"
	default n
	help
	  Sidewalk module to parse/write TLV data

if SIDEWALK_TLV
config SIDEWALK_TLV_RAM
	bool "RAM backend for TLV"
	default n
	help
	  RAM backend for Sidewalk TLV module

config SIDEWALK_TLV_FLASH
	bool "FLASH backend for TLV"
	default n
        imply FLASH
	help
	  FLASH backend for Sidewalk TLV module

endif #SIDEWALK_TLV
```

## west.yml
```yaml
#
# Copyright (c) 2025 Nordic Semiconductor ASA
#
# SPDX-License-Identifier: LicenseRef-Nordic-5-Clause
#

manifest:
  remotes:
    - name: ncs
      url-base: https://github.com/nrfconnect

  projects:
    - name: nrf
      remote: ncs
      repo-path: sdk-nrf
      revision: v3.4.0
      import:
        name-allowlist:
          - cmsis
          - cmsis_6
          - hal_nordic
          - mbedtls
          - mcuboot
          - nrfxlib
          - oberon-psa-crypto
          - qcbor
          - tf-psa-crypto
          - trusted-firmware-m
          - zcbor
          - zephyr
          - cmock

  self:
    path: sidewalk
```
