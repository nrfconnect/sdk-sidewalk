## CMakeLists.txt
```
#
# Copyright (c) 2022 Nordic Semiconductor ASA
#
# SPDX-License-Identifier: LicenseRef-Nordic-5-Clause
#

cmake_minimum_required(VERSION 3.20.0)
set(BOARD unit_testing)
find_package(Zephyr COMPONENTS unittest REQUIRED HINTS $ENV{ZEPHYR_BASE})
project(sidewalk_test_uptime)
get_filename_component(SIDEWALK_BASE ${CMAKE_CURRENT_LIST_DIR}/../../.. ABSOLUTE)
include(${SIDEWALK_BASE}/tests/cmake/sidewalk_test_ifc.cmake)

add_definitions(--include ztest.h)
add_definitions(-DARCH_STACK_PTR_ALIGN=8)
target_compile_definitions(testbinary PRIVATE CONFIG_SIDEWALK_LOG_LEVEL=0)

target_sources(testbinary PRIVATE
	src/main.c
	mock/zephyr_time.c
	mock/log_minimal.c
	${SIDEWALK_BASE}/subsys/sal/sid_pal/src/sid_uptime.c
)

target_include_directories(testbinary PRIVATE
	${SIDEWALK_BASE}/subsys/sal/sid_pal/include
)

sidewalk_link_test_ifc(testbinary ${SIDEWALK_BASE} ${CMAKE_CURRENT_BINARY_DIR} sid_pal_uptime_ifc)
```

## Kconfig
```
#
# Copyright (c) 2022 Nordic Semiconductor ASA
#
# SPDX-License-Identifier: LicenseRef-Nordic-5-Clause
#

config SIDEWALK_BUILD
	default y

config SIDEWALK_USE_PREBUILT_LIBRARIES
	default y

config SIDEWALK_PAL_ZEPHYR_LIBS_DISABLED
	default y

config SIDEWALK_UPTIME
	default y

config SIDEWALK_LOG
	default y
	imply LOG

config SIDEWALK_LOG_LEVEL
	default 0

config SIDEWALK_LOG_MSG_LENGTH_MAX
	default 80

source "Kconfig.zephyr"
```

## prj.conf
```kconfig
#
# Copyright (c) 2022 Nordic Semiconductor ASA
#
# SPDX-License-Identifier: LicenseRef-Nordic-4-Clause
#
CONFIG_UNITY=y
CONFIG_SIDEWALK_UPTIME=y
```

## src/main.c
```c
/*
 * Copyright (c) 2022 Nordic Semiconductor ASA
 *
 * SPDX-License-Identifier: LicenseRef-Nordic-5-Clause
 */
#include <zephyr/ztest.h>
#include <sid_pal_uptime_ifc.h>
#include <zephyr/sys_clock.h>

extern uint64_t test_zephyr_uptime_ns_value;

static void before_test(void *fixture)
{
	ARG_UNUSED(fixture);
	test_zephyr_uptime_ns_value = 0;
}

ZTEST_SUITE(pal_uptime, NULL, NULL, before_test, NULL, NULL);

static void uptime_test_time(uint64_t uptime_nanoseconds)
{
	uint32_t seconds, nanoseconds;
	struct sid_timespec sid_time;

	seconds = (uint32_t)(uptime_nanoseconds / NSEC_PER_SEC);
	nanoseconds = (uint32_t)(uptime_nanoseconds % NSEC_PER_SEC);

	test_zephyr_uptime_ns_value = uptime_nanoseconds;
	zassert_equal(SID_ERROR_NONE, sid_pal_uptime_now(&sid_time));

	zassert_equal(seconds, sid_time.tv_sec);
	zassert_equal(nanoseconds, sid_time.tv_nsec);
}

ZTEST(pal_uptime, test_sid_pal_uptime_get_now)
{
	zassert_equal(SID_ERROR_NULL_POINTER, sid_pal_uptime_now(NULL));

	uptime_test_time(0ull);
	uptime_test_time(1ull * NSEC_PER_SEC + 10ull);
	uptime_test_time(10ull * NSEC_PER_SEC + 100ull);
	uptime_test_time(LONG_MAX);
	uptime_test_time(LLONG_MAX);
	uptime_test_time(ULLONG_MAX);
}

ZTEST(pal_uptime, test_sid_pal_uptime_accuracy)
{
	int16_t ppm;

	ppm = sid_pal_uptime_get_xtal_ppm();
	sid_pal_uptime_set_xtal_ppm(ppm);
	zassert_equal(ppm, sid_pal_uptime_get_xtal_ppm());
}
```
