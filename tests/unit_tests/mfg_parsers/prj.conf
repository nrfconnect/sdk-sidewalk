## CMakeLists.txt
```
#
# Copyright (c) 2023 Nordic Semiconductor ASA
#
# SPDX-License-Identifier: LicenseRef-Nordic-5-Clause
#

cmake_minimum_required(VERSION 3.20.0)
find_package(Zephyr REQUIRED HINTS $ENV{ZEPHYR_BASE})
get_filename_component(SIDEWALK_BASE ${CMAKE_CURRENT_LIST_DIR}/../../.. ABSOLUTE)

project(device)

target_sources(app PRIVATE
	src/mfg_parser.c
	src/mock_mem.c
	src/sid_crypto_keys.c
	${SIDEWALK_BASE}/utils/tlv/tlv.c
	${SIDEWALK_BASE}/utils/tlv/tlv_ram_storage_impl.c
	${SIDEWALK_BASE}/utils/tlv/tlv_flash_storage_impl.c
	${SIDEWALK_BASE}/subsys/sal/sid_pal/src/sid_mfg_hex_v7.c
	${SIDEWALK_BASE}/subsys/sal/sid_pal/src/sid_mfg_hex_v8.c
)

target_include_directories(app PRIVATE
	.
	./mocks
	src
	${SIDEWALK_BASE}/utils/include
	${SIDEWALK_BASE}/subsys/sal/sid_pal/include
	${SIDEWALK_BASE}/subsys/app_utils/hal/include
	${SIDEWALK_BASE}/subsys/sal/common/public/sid_pal_ifc/mfg_store
	${SIDEWALK_BASE}/subsys/sal/common/public/sid_ifc/sid_error
	${SIDEWALK_BASE}/subsys/config/common/include
	${SIDEWALK_BASE}/subsys/app_utils/config/include
)
```

## Kconfig
```
#
# Copyright (c) 2023 Nordic Semiconductor ASA
#
# SPDX-License-Identifier: LicenseRef-Nordic-5-Clause
#

config LOG
	default false

config SIDEWALK_PAL_ZEPHYR_LIBS_DISABLED
	bool
	default y

config SIDEWALK_LOG_LEVEL
	default 0


config SIDEWALK_CRYPTO_PSA_KEY_STORAGE
	bool "PSA crypto storage for persistent Sidewalk keys"

source "$(APPLICATION_SOURCE_DIR)/../../../utils/Kconfig"
source "Kconfig.zephyr"
```

## prj.conf
```kconfig
#
# Copyright (c) 2023 Nordic Semiconductor ASA
#
# SPDX-License-Identifier: LicenseRef-Nordic-5-Clause
#
CONFIG_ZTEST=y
CONFIG_SIDEWALK_TLV=y
CONFIG_SIDEWALK_TLV_RAM=y
CONFIG_SIDEWALK_TLV_FLASH=y

CONFIG_FLASH=y
```

## boards/nrf52840dk_nrf52840.overlay
```dts
/*
 * Copyright (c) 2024 Nordic Semiconductor ASA
 *
 * SPDX-License-Identifier: LicenseRef-Nordic-5-Clause
 */

#include <samples/nrf52840dk_nrf52840_partitions.dtsi>
```

## boards/nrf54l15dk_nrf54l10_cpuapp.overlay
```dts
/*
 * Copyright (c) 2024 Nordic Semiconductor ASA
 *
 * SPDX-License-Identifier: LicenseRef-Nordic-5-Clause
 */

&mx25r64 {
	status = "okay";
};

#include <nrf54l10_cpuapp_partitions.dtsi>
```

## boards/nrf54l15dk_nrf54l15_cpuapp.overlay
```dts
/*
 * Copyright (c) 2024 Nordic Semiconductor ASA
 *
 * SPDX-License-Identifier: LicenseRef-Nordic-5-Clause
 */


#include <nrf54l15_cpuapp_memory.dtsi>
#include <nrf54l15_cpuapp_partitions.dtsi>
```

## src/mock_mem.c
```c
/**
 * Copyright (c) 2023 Nordic Semiconductor ASA
 * 
 * SPDX-License-Identifier: LicenseRef-Nordic-5-Clause
 */
#include <stdlib.h>
#include <zephyr/kernel.h>

K_HEAP_DEFINE(test_heap, KB(30));

void *sid_hal_malloc(size_t size)
{
	return k_heap_alloc(&test_heap, size, K_NO_WAIT);
}

void sid_hal_free(void *ptr)
{
	k_heap_free(&test_heap, ptr);
}
```

## src/sid_crypto_keys.c
```c
/*
 * Copyright (c) 2024 Nordic Semiconductor ASA
 *
 * SPDX-License-Identifier: LicenseRef-Nordic-5-Clause
 */
#include <sid_crypto_keys.h>
/**
 * @brief Init secure key storage for Sidewalk keys.
 * 
 * @return 0 on success, or -errno on failure.
 */
int sid_crypto_keys_init(void)
{
	return 0;
}

/**
 * @brief Import key value form buffer.
 * 
 * @note key value under given key id will be overwritten.
 * 
 * @param id [in] Key id to import data.
 * @param data [in] raw key data on input.
 * @param size [in] size of raw key data buffer.
 * @return 0 on success, or -errno on failure.
 */
int sid_crypto_keys_new_import(psa_key_id_t id, uint8_t *data, size_t size)
{
	return 0;
}

/**
 * @brief Generate a new key value.
 * 
 * @note key value under given key id will be overwritten.
 * 
 * @param id [in] Key id to generate new.
 * @param puk [in] Buffer with raw key value.
 * @param puk_size [in] Size of buffer with rew kay value.
 * @return 0 on success, or -errno on failure.
 */
int sid_crypto_keys_new_generate(psa_key_id_t id, uint8_t *puk, size_t puk_size)
{
	return 0;
}

/**
 * @brief Set key id in buffer.
 * 
 * @param id [in] Key id to write to the data buffer.
 * @param buffer [out] key id fulfilled with zeros.
 * @param size [in] size of raw key data buffer.
 * @return 0 on success, or -errno on failure.
 */
int sid_crypto_keys_buffer_set(psa_key_id_t id, uint8_t *buffer, size_t size)
{
	return 0;
}

/**
 * @brief Get key id from buffer.
 * 
 * @param id [out] psa key id from key data buffer.
 *  If key not found set to PSA_KEY_ID_NULL.
 * @param buffer [in] key data buffer.
 * @param size [in] size of key data buffer.
 * @return 0 on success, or -errno on failure.
 *  -ENOENT - if no key in buffer.
 */
int sid_crypto_keys_buffer_get(psa_key_id_t *id, uint8_t *buffer, size_t size)
{
	return 0;
}

/**
 * @brief Destroy key.
 * 
 * @note This operation is irreversible.
 * 
 * @param id [in] psa key id to be permanently removed.
 * @return 0 on success, or -errno on failure.
 */
int sid_crypto_keys_delete(psa_key_id_t id)
{
	return 0;
}

/**
 * @brief Deinit sidewalk key storage.
 * 
 * @return 0 on success, or -errno on failure. 
 */
int sid_crypto_keys_deinit(void)
{
	return 0;
}
```
