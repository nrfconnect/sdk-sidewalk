## CMakeLists.txt
```
#
# Copyright (c) 2022 Nordic Semiconductor ASA
#
# SPDX-License-Identifier: LicenseRef-Nordic-5-Clause
#

cmake_minimum_required(VERSION 3.20.0)

find_package(Zephyr REQUIRED HINTS $ENV{ZEPHYR_BASE})
project(sidewalk_test_critical_region)
set(SIDEWALK_BASE $ENV{ZEPHYR_BASE}/../sidewalk)

target_include_directories(app PRIVATE ${SIDEWALK_BASE}/subsys/sal/common/sid_pal_ifc)
target_include_directories(app PRIVATE src)
target_sources(app PRIVATE ${SIDEWALK_BASE}/subsys/sal/sid_pal/src/sid_critical_region.c)

# add test file
target_sources(app PRIVATE src/main.c)
```

## Kconfig
```
#
# Copyright (c) 2023 Nordic Semiconductor ASA
#
# SPDX-License-Identifier: LicenseRef-Nordic-5-Clause
#

config SIDEWALK_CRITICAL_REGION_RE_ENTRY_MAX
	default 2
	help
	  Maximum nesting level of critical region 
	  If the nesting level becomes greater than set by this config, assert will be triggered.

source "${ZEPHYR_BASE}/../sidewalk/Kconfig"
source "Kconfig.zephyr"
```

## prj.conf
```kconfig
#
# Copyright (c) 2022 Nordic Semiconductor ASA
#
# SPDX-License-Identifier: LicenseRef-Nordic-5-Clause
#
CONFIG_TEST=y
CONFIG_ZTEST=y
CONFIG_NO_OPTIMIZATIONS=y
CONFIG_IDLE_STACK_SIZE=1024
```

## src/main.c
```c
/*
 * Copyright (c) 2022 Nordic Semiconductor ASA
 *
 * SPDX-License-Identifier: LicenseRef-Nordic-5-Clause
 */
#include <stdint.h>
#include <zephyr/ztest.h>

#include <sid_pal_critical_region_ifc.h>

#include <zephyr/irq.h>
#include <zephyr/kernel.h>

#include <zephyr/interrupt_util.h>

#define TEST_IRQ (24)
#define TEST_IRQ2 (25)
#define TEST_IRQ3 (26)
#define TEST_IRQ4 (27)
#define TEST_IRQ_PRIO (2)

#define DELAY_BEFORE_IRQ_CHECK_US (50)

void irq_cb(const void *arg)
{
	*(uint32_t *)arg += 1;
}

ZTEST(pal_critical_region, test_sid_pal_critical_region)
{
	static uint32_t call_count = 0;
	static volatile uint32_t expected_callcount = 0;
	IRQ_CONNECT(TEST_IRQ, TEST_IRQ_PRIO, irq_cb, (const void *)&call_count, 0);
	irq_enable(TEST_IRQ);

	trigger_irq(TEST_IRQ);
	k_busy_wait(DELAY_BEFORE_IRQ_CHECK_US);
	expected_callcount++;
	zassert_equal(expected_callcount, call_count);

	sid_pal_enter_critical_region();
	{
		trigger_irq(TEST_IRQ);
		k_busy_wait(DELAY_BEFORE_IRQ_CHECK_US);
		zassert_equal(expected_callcount, call_count);
	}
	sid_pal_exit_critical_region();

	expected_callcount++;
	zassert_equal(expected_callcount, call_count);

	trigger_irq(TEST_IRQ);
	k_busy_wait(DELAY_BEFORE_IRQ_CHECK_US);
	expected_callcount++;
	zassert_equal(expected_callcount, call_count);
}

ZTEST(pal_critical_region, test_sid_pal_critical_multiple_entry)
{
	static uint32_t call_count = 0;
	static volatile uint32_t expected_callcount = 0;
	IRQ_CONNECT(TEST_IRQ3, TEST_IRQ_PRIO, irq_cb, (const void *)&call_count, 0);
	irq_enable(TEST_IRQ3);

	trigger_irq(TEST_IRQ3);
	k_busy_wait(DELAY_BEFORE_IRQ_CHECK_US);
	expected_callcount++;
	zassert_equal(expected_callcount, call_count);

	sid_pal_enter_critical_region();
	{
		trigger_irq(TEST_IRQ3);
		k_busy_wait(DELAY_BEFORE_IRQ_CHECK_US);
		zassert_equal(expected_callcount, call_count);

		sid_pal_enter_critical_region();
		{
			zassert_equal(expected_callcount, call_count);
		}
		sid_pal_exit_critical_region();
		zassert_equal(expected_callcount, call_count);
	}
	sid_pal_exit_critical_region();

	expected_callcount++;
	zassert_equal(expected_callcount, call_count);
	trigger_irq(TEST_IRQ3);
	k_busy_wait(DELAY_BEFORE_IRQ_CHECK_US);
	expected_callcount++;
	zassert_equal(expected_callcount, call_count);
}

ZTEST(pal_critical_region, test_sid_pal_critical_region_multiple_entry_multiple_irq)
{
	static uint32_t call_count = 0;
	static volatile uint32_t expected_callcount = 0;
	IRQ_CONNECT(TEST_IRQ4, TEST_IRQ_PRIO, irq_cb, (const void *)&call_count, 0);
	irq_enable(TEST_IRQ4);

	trigger_irq(TEST_IRQ4);
	k_busy_wait(DELAY_BEFORE_IRQ_CHECK_US);
	expected_callcount++;
	zassert_equal(expected_callcount, call_count);

	sid_pal_enter_critical_region();
	{
		trigger_irq(TEST_IRQ4);
		k_busy_wait(DELAY_BEFORE_IRQ_CHECK_US);
		zassert_equal(expected_callcount, call_count);
		sid_pal_enter_critical_region();
		{
			trigger_irq(TEST_IRQ4);
			k_busy_wait(DELAY_BEFORE_IRQ_CHECK_US);
			zassert_equal(expected_callcount, call_count);
		}
		sid_pal_exit_critical_region();
		k_busy_wait(DELAY_BEFORE_IRQ_CHECK_US);
		zassert_equal(expected_callcount, call_count);
	}
	sid_pal_exit_critical_region();

	// only one IRQ is queued
	k_busy_wait(DELAY_BEFORE_IRQ_CHECK_US);
	expected_callcount++;
	zassert_equal(expected_callcount, call_count);

	trigger_irq(TEST_IRQ4);
	k_busy_wait(DELAY_BEFORE_IRQ_CHECK_US);
	expected_callcount++;
	zassert_equal(expected_callcount, call_count);
}

ZTEST(pal_critical_region, test_sanity)
{
	zassert_true(true);
}

ZTEST_SUITE(pal_critical_region, NULL, NULL, NULL, NULL, NULL);
```

## src/fix_zassert_macro.h
```c
/*
 * Copyright (c) 2022 Nordic Semiconductor ASA
 *
 * SPDX-License-Identifier: LicenseRef-Nordic-5-Clause
 */

#define zassert_true(a, ...)
```

## src/interrupt_util.h
```c
/*
 * Copyright (c) 2022 Nordic Semiconductor ASA
 *
 * SPDX-License-Identifier: LicenseRef-Nordic-4-Clause
 */
#ifndef INTERRUPT_UTIL_H_
#define INTERRUPT_UTIL_H_

#if defined(CONFIG_ARCH_POSIX)
#include <irq_ctrl.h>

static inline void trigger_irq(int irq)
{
	hw_irq_ctrl_raise_im_from_sw(irq);
}

#elif defined(CONFIG_CPU_CORTEX_M)
#include <arch/arm/aarch32/cortex_m/cmsis.h>

static inline void trigger_irq(int irq)
{
#if defined(CONFIG_CPU_CORTEX_M0) || defined(CONFIG_CPU_CORTEX_M0PLUS) \
	|| defined(CONFIG_CPU_CORTEX_M1) || defined(CONFIG_ARMV6_M_ARMV8_M_BASELINE)
	/* QEMU does not simulate the STIR register: this is a workaround */
	NVIC_SetPendingIRQ(irq);
#else
	NVIC->STIR = irq;
#endif
}

#else
#error "Architecture not supported"
#endif

#endif /* INTERRUPT_UTIL_H_ */
```
